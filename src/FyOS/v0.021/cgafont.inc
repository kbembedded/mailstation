
	.db #0x00, #0x7e, #0x7e, #0x36, #0x08, #0x1c, #0x08, #0x00
	.db #0xff, #0x00, #0xff, #0xf0, #0x3c, #0xfc, #0xfe, #0x18
	.db #0x01, #0x40, #0x18, #0x66, #0xfe, #0x7c, #0x00, #0x18
	.db #0x18, #0x18, #0x00, #0x00, #0x00, #0x00, #0x00, #0x00
	.db #0x00, #0x0c, #0x36, #0x36, #0x0c, #0x00, #0x1c, #0x06
	.db #0x18, #0x06, #0x00, #0x00, #0x00, #0x00, #0x00, #0x60
	.db #0x3e, #0x0c, #0x1e, #0x1e, #0x38, #0x3f, #0x1c, #0x3f
	.db #0x1e, #0x1e, #0x00, #0x00, #0x18, #0x00, #0x06, #0x1e
	.db #0x3e, #0x0c, #0x3f, #0x3c, #0x1f, #0x7f, #0x7f, #0x3c
	.db #0x33, #0x1e, #0x78, #0x67, #0x0f, #0x63, #0x63, #0x1c
	.db #0x3f, #0x1e, #0x3f, #0x1e, #0x3f, #0x33, #0x33, #0x63
	.db #0x63, #0x33, #0x7f, #0x1e, #0x03, #0x1e, #0x08, #0x00
	.db #0x0c, #0x00, #0x07, #0x00, #0x38, #0x00, #0x1c, #0x00
	.db #0x07, #0x0c, #0x30, #0x07, #0x0e, #0x00, #0x00, #0x00
	.db #0x00, #0x00, #0x00, #0x00, #0x08, #0x00, #0x00, #0x00
	.db #0x00, #0x00, #0x00, #0x38, #0x18, #0x07, #0x6e, #0x00
	.db #0x1e, #0x00, #0x38, #0x7e, #0x33, #0x07, #0x0c, #0x00
	.db #0x7e, #0x33, #0x07, #0x33, #0x3e, #0x07, #0x63, #0x0c
	.db #0x38, #0x00, #0x7c, #0x1e, #0x00, #0x00, #0x1e, #0x00
	.db #0x00, #0xc3, #0x33, #0x18, #0x1c, #0x33, #0x1f, #0x70
	.db #0x38, #0x1c, #0x00, #0x00, #0x00, #0x3f, #0x3c, #0x1c
	.db #0x0c, #0x00, #0x00, #0xc3, #0xc3, #0x18, #0x00, #0x00
	.db #0x44, #0xaa, #0xdb, #0x18, #0x18, #0x18, #0x6c, #0x00
	.db #0x00, #0x6c, #0x6c, #0x00, #0x6c, #0x6c, #0x18, #0x00
	.db #0x18, #0x18, #0x00, #0x18, #0x00, #0x18, #0x18, #0x6c
	.db #0x6c, #0x00, #0x6c, #0x00, #0x6c, #0x00, #0x6c, #0x18
	.db #0x6c, #0x00, #0x00, #0x6c, #0x18, #0x00, #0x00, #0x6c
	.db #0x18, #0x18, #0x00, #0xff, #0x00, #0x0f, #0xf0, #0xff
	.db #0x00, #0x00, #0x00, #0x00, #0x3f, #0x00, #0x00, #0x00
	.db #0x3f, #0x1c, #0x1c, #0x38, #0x00, #0x60, #0x1c, #0x1e
	.db #0x00, #0x0c, #0x06, #0x18, #0x70, #0x18, #0x0c, #0x00
	.db #0x1c, #0x00, #0x00, #0xf0, #0x1e, #0x0e, #0x00, #0x00


	.db #0x00, #0x81, #0xff, #0x7f, #0x1c, #0x3e, #0x08, #0x00
	.db #0xff, #0x3c, #0xc3, #0xe0, #0x66, #0xcc, #0xc6, #0xdb
	.db #0x07, #0x70, #0x3c, #0x66, #0xdb, #0xc6, #0x00, #0x3c
	.db #0x3c, #0x18, #0x18, #0x0c, #0x00, #0x24, #0x18, #0xff
	.db #0x00, #0x1e, #0x36, #0x36, #0x3e, #0x63, #0x36, #0x06
	.db #0x0c, #0x0c, #0x66, #0x0c, #0x00, #0x00, #0x00, #0x30
	.db #0x63, #0x0e, #0x33, #0x33, #0x3c, #0x03, #0x06, #0x33
	.db #0x33, #0x33, #0x0c, #0x0c, #0x0c, #0x00, #0x0c, #0x33
	.db #0x63, #0x1e, #0x66, #0x66, #0x36, #0x46, #0x46, #0x66
	.db #0x33, #0x0c, #0x30, #0x66, #0x06, #0x77, #0x67, #0x36
	.db #0x66, #0x33, #0x66, #0x33, #0x2d, #0x33, #0x33, #0x63
	.db #0x63, #0x33, #0x63, #0x06, #0x06, #0x18, #0x1c, #0x00
	.db #0x0c, #0x00, #0x06, #0x00, #0x30, #0x00, #0x36, #0x00
	.db #0x06, #0x00, #0x00, #0x06, #0x0c, #0x00, #0x00, #0x00
	.db #0x00, #0x00, #0x00, #0x00, #0x0c, #0x00, #0x00, #0x00
	.db #0x00, #0x00, #0x00, #0x0c, #0x18, #0x0c, #0x3b, #0x08
	.db #0x33, #0x33, #0x00, #0xc3, #0x00, #0x00, #0x0c, #0x00
	.db #0xc3, #0x00, #0x00, #0x00, #0x63, #0x00, #0x1c, #0x0c
	.db #0x00, #0x00, #0x36, #0x33, #0x33, #0x07, #0x33, #0x07
	.db #0x33, #0x18, #0x00, #0x18, #0x36, #0x33, #0x33, #0xd8
	.db #0x00, #0x00, #0x38, #0x38, #0x1f, #0x00, #0x36, #0x36
	.db #0x00, #0x00, #0x00, #0x63, #0x63, #0x18, #0xcc, #0x33
	.db #0x11, #0x55, #0xee, #0x18, #0x18, #0x18, #0x6c, #0x00
	.db #0x00, #0x6c, #0x6c, #0x00, #0x6c, #0x6c, #0x18, #0x00
	.db #0x18, #0x18, #0x00, #0x18, #0x00, #0x18, #0x18, #0x6c
	.db #0x6c, #0x00, #0x6c, #0x00, #0x6c, #0x00, #0x6c, #0x18
	.db #0x6c, #0x00, #0x00, #0x6c, #0x18, #0x00, #0x00, #0x6c
	.db #0x18, #0x18, #0x00, #0xff, #0x00, #0x0f, #0xf0, #0xff
	.db #0x00, #0x1e, #0x3f, #0x7f, #0x33, #0x00, #0x66, #0x6e
	.db #0x0c, #0x36, #0x36, #0x0c, #0x00, #0x30, #0x06, #0x33
	.db #0x3f, #0x0c, #0x0c, #0x0c, #0xd8, #0x18, #0x0c, #0x6e
	.db #0x36, #0x00, #0x00, #0x30, #0x36, #0x18, #0x00, #0x00

	.db #0x00, #0xa5, #0xdb, #0x7f, #0x3e, #0x1c, #0x1c, #0x18
	.db #0xe7, #0x66, #0x99, #0xf0, #0x66, #0xfc, #0xfe, #0x3c
	.db #0x1f, #0x7c, #0x7e, #0x66, #0xdb, #0x1c, #0x00, #0x7e
	.db #0x7e, #0x18, #0x30, #0x06, #0x03, #0x66, #0x3c, #0xff
	.db #0x00, #0x1e, #0x36, #0x7f, #0x03, #0x33, #0x1c, #0x03
	.db #0x06, #0x18, #0x3c, #0x0c, #0x00, #0x00, #0x00, #0x18
	.db #0x73, #0x0c, #0x30, #0x30, #0x36, #0x1f, #0x03, #0x30
	.db #0x33, #0x33, #0x0c, #0x0c, #0x06, #0x3f, #0x18, #0x30
	.db #0x7b, #0x33, #0x66, #0x03, #0x66, #0x16, #0x16, #0x03
	.db #0x33, #0x0c, #0x30, #0x36, #0x06, #0x7f, #0x6f, #0x63
	.db #0x66, #0x33, #0x66, #0x06, #0x0c, #0x33, #0x33, #0x63
	.db #0x36, #0x33, #0x31, #0x06, #0x0c, #0x18, #0x36, #0x00
	.db #0x18, #0x1e, #0x06, #0x1e, #0x30, #0x1e, #0x06, #0x6e
	.db #0x36, #0x0e, #0x30, #0x66, #0x0c, #0x33, #0x1f, #0x1e
	.db #0x3b, #0x6e, #0x3b, #0x3e, #0x3e, #0x33, #0x33, #0x63
	.db #0x63, #0x33, #0x3f, #0x0c, #0x18, #0x0c, #0x00, #0x1c
	.db #0x03, #0x00, #0x1e, #0x3c, #0x1e, #0x1e, #0x1e, #0x1e
	.db #0x3c, #0x1e, #0x1e, #0x0e, #0x1c, #0x0e, #0x36, #0x00
	.db #0x3f, #0xfe, #0x33, #0x00, #0x00, #0x00, #0x00, #0x00
	.db #0x00, #0x3c, #0x33, #0x7e, #0x26, #0x1e, #0x33, #0x18
	.db #0x1e, #0x0e, #0x00, #0x00, #0x00, #0x33, #0x36, #0x36
	.db #0x0c, #0x00, #0x00, #0x33, #0x33, #0x00, #0x66, #0x66
	.db #0x44, #0xaa, #0xdb, #0x18, #0x18, #0x1f, #0x6c, #0x00
	.db #0x1f, #0x6f, #0x6c, #0x7f, #0x6f, #0x6c, #0x1f, #0x00
	.db #0x18, #0x18, #0x00, #0x18, #0x00, #0x18, #0xf8, #0x6c
	.db #0xec, #0xfc, #0xef, #0xff, #0xec, #0xff, #0xef, #0xff
	.db #0x6c, #0xff, #0x00, #0x6c, #0xf8, #0xf8, #0x00, #0x6c
	.db #0xff, #0x18, #0x00, #0xff, #0x00, #0x0f, #0xf0, #0xff
	.db #0x6e, #0x33, #0x33, #0x36, #0x06, #0x7e, #0x66, #0x3b
	.db #0x1e, #0x63, #0x63, #0x18, #0x7e, #0x7e, #0x03, #0x33
	.db #0x00, #0x3f, #0x18, #0x06, #0xd8, #0x18, #0x00, #0x3b
	.db #0x36, #0x00, #0x00, #0x30, #0x36, #0x0c, #0x3c, #0x00

	.db #0x00, #0x81, #0xff, #0x7f, #0x7f, #0x7f, #0x3e, #0x3c
	.db #0xc3, #0x42, #0xbd, #0xbe, #0x66, #0x0c, #0xc6, #0xe7
	.db #0x7f, #0x7f, #0x18, #0x66, #0xde, #0x36, #0x00, #0x18
	.db #0x18, #0x18, #0x7f, #0x7f, #0x03, #0xff, #0x7e, #0x7e
	.db #0x00, #0x0c, #0x00, #0x36, #0x1e, #0x18, #0x6e, #0x00
	.db #0x06, #0x18, #0xff, #0x3f, #0x00, #0x3f, #0x00, #0x0c
	.db #0x7b, #0x0c, #0x1c, #0x1c, #0x33, #0x30, #0x1f, #0x18
	.db #0x1e, #0x3e, #0x00, #0x00, #0x03, #0x00, #0x30, #0x18
	.db #0x7b, #0x33, #0x3e, #0x03, #0x66, #0x1e, #0x1e, #0x03
	.db #0x3f, #0x0c, #0x30, #0x1e, #0x06, #0x7f, #0x7b, #0x63
	.db #0x3e, #0x33, #0x3e, #0x0c, #0x0c, #0x33, #0x33, #0x6b
	.db #0x1c, #0x1e, #0x18, #0x06, #0x18, #0x18, #0x63, #0x00
	.db #0x00, #0x30, #0x3e, #0x33, #0x3e, #0x33, #0x0f, #0x33
	.db #0x6e, #0x0c, #0x30, #0x36, #0x0c, #0x7f, #0x33, #0x33
	.db #0x66, #0x33, #0x6e, #0x03, #0x0c, #0x33, #0x33, #0x6b
	.db #0x36, #0x33, #0x19, #0x07, #0x00, #0x38, #0x00, #0x36
	.db #0x33, #0x33, #0x33, #0x60, #0x30, #0x30, #0x30, #0x03
	.db #0x66, #0x33, #0x33, #0x0c, #0x18, #0x0c, #0x63, #0x1e
	.db #0x06, #0x30, #0x7f, #0x1e, #0x1e, #0x1e, #0x33, #0x33
	.db #0x33, #0x66, #0x33, #0x03, #0x0f, #0x3f, #0x5f, #0x3c
	.db #0x30, #0x0c, #0x1e, #0x33, #0x1f, #0x37, #0x7c, #0x1c
	.db #0x06, #0x3f, #0x3f, #0x7b, #0xdb, #0x18, #0x33, #0xcc
	.db #0x11, #0x55, #0x77, #0x18, #0x18, #0x18, #0x6c, #0x00
	.db #0x18, #0x60, #0x6c, #0x60, #0x60, #0x6c, #0x18, #0x00
	.db #0x18, #0x18, #0x00, #0x18, #0x00, #0x18, #0x18, #0x6c
	.db #0x0c, #0x0c, #0x00, #0x00, #0x0c, #0x00, #0x00, #0x00
	.db #0x6c, #0x00, #0x00, #0x6c, #0x18, #0x18, #0x00, #0x6c
	.db #0x18, #0x18, #0x00, #0xff, #0x00, #0x0f, #0xf0, #0xff
	.db #0x3b, #0x1f, #0x03, #0x36, #0x0c, #0x1b, #0x66, #0x18
	.db #0x33, #0x7f, #0x63, #0x3e, #0xdb, #0xdb, #0x1f, #0x33
	.db #0x3f, #0x0c, #0x0c, #0x0c, #0x18, #0x18, #0x3f, #0x00
	.db #0x1c, #0x18, #0x00, #0x30, #0x36, #0x06, #0x3c, #0x00

	.db #0x00, #0xbd, #0xc3, #0x3e, #0x3e, #0x7f, #0x7f, #0x3c
	.db #0xc3, #0x42, #0xbd, #0x33, #0x3c, #0x0c, #0xc6, #0xe7
	.db #0x1f, #0x7c, #0x18, #0x66, #0xd8, #0x36, #0x7e, #0x7e
	.db #0x18, #0x7e, #0x30, #0x06, #0x03, #0x66, #0xff, #0x3c
	.db #0x00, #0x0c, #0x00, #0x7f, #0x30, #0x0c, #0x3b, #0x00
	.db #0x06, #0x18, #0x3c, #0x0c, #0x00, #0x00, #0x00, #0x06
	.db #0x6f, #0x0c, #0x06, #0x30, #0x7f, #0x30, #0x33, #0x0c
	.db #0x33, #0x30, #0x00, #0x00, #0x06, #0x00, #0x18, #0x0c
	.db #0x7b, #0x3f, #0x66, #0x03, #0x66, #0x16, #0x16, #0x73
	.db #0x33, #0x0c, #0x33, #0x36, #0x46, #0x6b, #0x73, #0x63
	.db #0x06, #0x3b, #0x36, #0x18, #0x0c, #0x33, #0x33, #0x7f
	.db #0x1c, #0x0c, #0x4c, #0x06, #0x30, #0x18, #0x00, #0x00
	.db #0x00, #0x3e, #0x66, #0x03, #0x33, #0x3f, #0x06, #0x33
	.db #0x66, #0x0c, #0x30, #0x1e, #0x0c, #0x7f, #0x33, #0x33
	.db #0x66, #0x33, #0x66, #0x1e, #0x0c, #0x33, #0x33, #0x7f
	.db #0x1c, #0x33, #0x0c, #0x0c, #0x18, #0x0c, #0x00, #0x63
	.db #0x1e, #0x33, #0x3f, #0x7c, #0x3e, #0x3e, #0x3e, #0x03
	.db #0x7e, #0x3f, #0x3f, #0x0c, #0x18, #0x0c, #0x7f, #0x33
	.db #0x1e, #0xfe, #0x33, #0x33, #0x33, #0x33, #0x33, #0x33
	.db #0x33, #0x66, #0x33, #0x03, #0x06, #0x0c, #0x63, #0x18
	.db #0x3e, #0x0c, #0x33, #0x33, #0x33, #0x3f, #0x00, #0x00
	.db #0x03, #0x03, #0x30, #0xcc, #0xec, #0x18, #0x66, #0x66
	.db #0x44, #0xaa, #0xdb, #0x18, #0x1f, #0x1f, #0x6f, #0x7f
	.db #0x1f, #0x6f, #0x6c, #0x6f, #0x7f, #0x7f, #0x1f, #0x1f
	.db #0xf8, #0xff, #0xff, #0xf8, #0xff, #0xff, #0xf8, #0xec
	.db #0xfc, #0xec, #0xff, #0xef, #0xec, #0xff, #0xef, #0xff
	.db #0xff, #0xff, #0xff, #0xfc, #0xf8, #0xf8, #0xfc, #0xff
	.db #0xff, #0x1f, #0xf8, #0xff, #0xff, #0x0f, #0xf0, #0x00
	.db #0x13, #0x33, #0x03, #0x36, #0x06, #0x1b, #0x66, #0x18
	.db #0x33, #0x63, #0x36, #0x33, #0xdb, #0xdb, #0x03, #0x33
	.db #0x00, #0x0c, #0x06, #0x18, #0x18, #0x18, #0x00, #0x6e
	.db #0x00, #0x18, #0x18, #0x37, #0x36, #0x1e, #0x3c, #0x00

	.db #0x00, #0x99, #0xe7, #0x1c, #0x1c, #0x6b, #0x3e, #0x18
	.db #0xe7, #0x66, #0x99, #0x33, #0x18, #0x0e, #0xe6, #0x3c
	.db #0x07, #0x70, #0x7e, #0x00, #0xd8, #0x1c, #0x7e, #0x3c
	.db #0x18, #0x3c, #0x18, #0x0c, #0x7f, #0x24, #0xff, #0x18
	.db #0x00, #0x00, #0x00, #0x36, #0x1f, #0x66, #0x33, #0x00
	.db #0x0c, #0x0c, #0x66, #0x0c, #0x0c, #0x00, #0x0c, #0x03
	.db #0x67, #0x0c, #0x33, #0x33, #0x30, #0x33, #0x33, #0x0c
	.db #0x33, #0x18, #0x0c, #0x0c, #0x0c, #0x3f, #0x0c, #0x00
	.db #0x03, #0x33, #0x66, #0x66, #0x36, #0x46, #0x06, #0x66
	.db #0x33, #0x0c, #0x33, #0x66, #0x66, #0x63, #0x63, #0x36
	.db #0x06, #0x1e, #0x66, #0x33, #0x0c, #0x33, #0x1e, #0x77
	.db #0x36, #0x0c, #0x66, #0x06, #0x60, #0x18, #0x00, #0x00
	.db #0x00, #0x33, #0x66, #0x33, #0x33, #0x03, #0x06, #0x3e
	.db #0x66, #0x0c, #0x33, #0x36, #0x0c, #0x6b, #0x33, #0x33
	.db #0x3e, #0x3e, #0x06, #0x30, #0x2c, #0x33, #0x1e, #0x7f
	.db #0x36, #0x3e, #0x26, #0x0c, #0x18, #0x0c, #0x00, #0x63
	.db #0x18, #0x33, #0x03, #0x66, #0x33, #0x33, #0x33, #0x1e
	.db #0x06, #0x03, #0x03, #0x0c, #0x18, #0x0c, #0x63, #0x3f
	.db #0x06, #0x33, #0x33, #0x33, #0x33, #0x33, #0x33, #0x33
	.db #0x3e, #0x3c, #0x33, #0x7e, #0x67, #0x3f, #0xf3, #0x18
	.db #0x33, #0x0c, #0x33, #0x33, #0x33, #0x3b, #0x7e, #0x3e
	.db #0x33, #0x03, #0x30, #0x66, #0xf6, #0x18, #0xcc, #0x33
	.db #0x11, #0x55, #0xee, #0x18, #0x18, #0x18, #0x6c, #0x6c
	.db #0x18, #0x6c, #0x6c, #0x6c, #0x00, #0x00, #0x00, #0x18
	.db #0x00, #0x00, #0x18, #0x18, #0x00, #0x18, #0x18, #0x6c
	.db #0x00, #0x6c, #0x00, #0x6c, #0x6c, #0x00, #0x6c, #0x00
	.db #0x00, #0x18, #0x6c, #0x00, #0x00, #0x18, #0x6c, #0x6c
	.db #0x18, #0x00, #0x18, #0xff, #0xff, #0x0f, #0xf0, #0x00
	.db #0x3b, #0x1f, #0x03, #0x36, #0x33, #0x1b, #0x3e, #0x18
	.db #0x1e, #0x36, #0x36, #0x33, #0x7e, #0x7e, #0x06, #0x33
	.db #0x3f, #0x00, #0x00, #0x00, #0x18, #0x1b, #0x0c, #0x3b
	.db #0x00, #0x00, #0x00, #0x36, #0x00, #0x00, #0x3c, #0x00

	.db #0x00, #0x81, #0xff, #0x08, #0x08, #0x08, #0x08, #0x00
	.db #0xff, #0x3c, #0xc3, #0x33, #0x7e, #0x0f, #0x67, #0xdb
	.db #0x01, #0x40, #0x3c, #0x66, #0xd8, #0x33, #0x7e, #0x18
	.db #0x18, #0x18, #0x00, #0x00, #0x00, #0x00, #0x00, #0x00
	.db #0x00, #0x0c, #0x00, #0x36, #0x0c, #0x63, #0x6e, #0x00
	.db #0x18, #0x06, #0x00, #0x00, #0x0c, #0x00, #0x0c, #0x01
	.db #0x3e, #0x3f, #0x3f, #0x1e, #0x78, #0x1e, #0x1e, #0x0c
	.db #0x1e, #0x0e, #0x0c, #0x0c, #0x18, #0x00, #0x06, #0x0c
	.db #0x1e, #0x33, #0x3f, #0x3c, #0x1f, #0x7f, #0x0f, #0x7c
	.db #0x33, #0x1e, #0x1e, #0x67, #0x7f, #0x63, #0x63, #0x1c
	.db #0x0f, #0x38, #0x67, #0x1e, #0x1e, #0x3f, #0x0c, #0x63
	.db #0x63, #0x1e, #0x7f, #0x1e, #0x40, #0x1e, #0x00, #0x00
	.db #0x00, #0x6e, #0x3b, #0x1e, #0x6e, #0x1e, #0x0f, #0x30
	.db #0x67, #0x1e, #0x33, #0x67, #0x1e, #0x63, #0x33, #0x1e
	.db #0x06, #0x30, #0x0f, #0x1f, #0x18, #0x6e, #0x0c, #0x36
	.db #0x63, #0x30, #0x3f, #0x38, #0x18, #0x07, #0x00, #0x7f
	.db #0x30, #0x7e, #0x1e, #0xfc, #0x7e, #0x7e, #0x7e, #0x30
	.db #0x3c, #0x1e, #0x1e, #0x1e, #0x3c, #0x1e, #0x63, #0x33
	.db #0x3f, #0xfe, #0x73, #0x1e, #0x1e, #0x1e, #0x7e, #0x7e
	.db #0x30, #0x18, #0x1e, #0x18, #0x3f, #0x0c, #0x63, #0x1b
	.db #0x7e, #0x1e, #0x1e, #0x7e, #0x33, #0x33, #0x00, #0x00
	.db #0x1e, #0x00, #0x00, #0x33, #0xf3, #0x18, #0x00, #0x00
	.db #0x44, #0xaa, #0xdb, #0x18, #0x18, #0x18, #0x6c, #0x6c
	.db #0x18, #0x6c, #0x6c, #0x6c, #0x00, #0x00, #0x00, #0x18
	.db #0x00, #0x00, #0x18, #0x18, #0x00, #0x18, #0x18, #0x6c
	.db #0x00, #0x6c, #0x00, #0x6c, #0x6c, #0x00, #0x6c, #0x00
	.db #0x00, #0x18, #0x6c, #0x00, #0x00, #0x18, #0x6c, #0x6c
	.db #0x18, #0x00, #0x18, #0xff, #0xff, #0x0f, #0xf0, #0x00
	.db #0x6e, #0x03, #0x03, #0x36, #0x3f, #0x0e, #0x06, #0x18
	.db #0x0c, #0x1c, #0x77, #0x1e, #0x00, #0x06, #0x1c, #0x33
	.db #0x00, #0x3f, #0x3f, #0x3f, #0x18, #0x1b, #0x0c, #0x00
	.db #0x00, #0x00, #0x00, #0x3c, #0x00, #0x00, #0x00, #0x00

	.db #0x00, #0x7e, #0x7e, #0x00, #0x00, #0x1c, #0x1c, #0x00
	.db #0xff, #0x00, #0xff, #0x1e, #0x18, #0x07, #0x03, #0x18
	.db #0x00, #0x00, #0x18, #0x00, #0x00, #0x1e, #0x00, #0xff
	.db #0x00, #0x00, #0x00, #0x00, #0x00, #0x00, #0x00, #0x00
	.db #0x00, #0x00, #0x00, #0x00, #0x00, #0x00, #0x00, #0x00
	.db #0x00, #0x00, #0x00, #0x00, #0x06, #0x00, #0x00, #0x00
	.db #0x00, #0x00, #0x00, #0x00, #0x00, #0x00, #0x00, #0x00
	.db #0x00, #0x00, #0x00, #0x06, #0x00, #0x00, #0x00, #0x00
	.db #0x00, #0x00, #0x00, #0x00, #0x00, #0x00, #0x00, #0x00
	.db #0x00, #0x00, #0x00, #0x00, #0x00, #0x00, #0x00, #0x00
	.db #0x00, #0x00, #0x00, #0x00, #0x00, #0x00, #0x00, #0x00
	.db #0x00, #0x00, #0x00, #0x00, #0x00, #0x00, #0x00, #0xff
	.db #0x00, #0x00, #0x00, #0x00, #0x00, #0x00, #0x00, #0x1f
	.db #0x00, #0x00, #0x1e, #0x00, #0x00, #0x00, #0x00, #0x00
	.db #0x0f, #0x78, #0x00, #0x00, #0x00, #0x00, #0x00, #0x00
	.db #0x00, #0x1f, #0x00, #0x00, #0x00, #0x00, #0x00, #0x00
	.db #0x1e, #0x00, #0x00, #0x00, #0x00, #0x00, #0x00, #0x1c
	.db #0x00, #0x00, #0x00, #0x00, #0x00, #0x00, #0x00, #0x00
	.db #0x00, #0x00, #0x00, #0x00, #0x00, #0x00, #0x00, #0x00
	.db #0x1f, #0x00, #0x00, #0x18, #0x00, #0x0c, #0xe3, #0x0e
	.db #0x00, #0x00, #0x00, #0x00, #0x00, #0x00, #0x00, #0x00
	.db #0x00, #0x00, #0x00, #0xf0, #0xc0, #0x00, #0x00, #0x00
	.db #0x11, #0x55, #0x77, #0x18, #0x18, #0x18, #0x6c, #0x6c
	.db #0x18, #0x6c, #0x6c, #0x6c, #0x00, #0x00, #0x00, #0x18
	.db #0x00, #0x00, #0x18, #0x18, #0x00, #0x18, #0x18, #0x6c
	.db #0x00, #0x6c, #0x00, #0x6c, #0x6c, #0x00, #0x6c, #0x00
	.db #0x00, #0x18, #0x6c, #0x00, #0x00, #0x18, #0x6c, #0x6c
	.db #0x18, #0x00, #0x18, #0xff, #0xff, #0x0f, #0xf0, #0x00
	.db #0x00, #0x03, #0x00, #0x00, #0x00, #0x00, #0x03, #0x00
	.db #0x3f, #0x00, #0x00, #0x00, #0x00, #0x03, #0x00, #0x00
	.db #0x00, #0x00, #0x00, #0x00, #0x18, #0x0e, #0x00, #0x00
	.db #0x00, #0x00, #0x00, #0x38, #0x00, #0x00, #0x00, #0x00


