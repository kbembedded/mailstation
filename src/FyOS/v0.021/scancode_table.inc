
; lowercase
	.db	#0d000, #0d000, #0d000, #0d000, #0d000, #0d000, #0d000, #0d000
	.db	#0d255, #0d255, #0d255, #0d064, #0d000, #0d000, #0d000, #0d000
	.db	#0d096, #0d049, #0d050, #0d051, #0d052, #0d053, #0d054, #0d055
	.db	#0d056, #0d057, #0d048, #0d045, #0d061, #0d008, #0d092, #0d000
	.db	#0d009, #0d113, #0d119, #0d101, #0d114, #0d116, #0d121, #0d117
	.db	#0d105, #0d111, #0d112, #0d091, #0d093, #0d059, #0d039, #0d013
	.db	#0d255, #0d097, #0d115, #0d100, #0d102, #0d103, #0d104, #0d106
	.db	#0d107, #0d108, #0d044, #0d046, #0d047, #0d000, #0d000, #0d000
	.db	#0d255, #0d122, #0d120, #0d099, #0d118, #0d098, #0d110, #0d109
	.db	#0d255, #0d255, #0d255, #0d032, #0d255, #0d255, #0d255, #0d000
; uppercase
	.db	#0d000, #0d000, #0d000, #0d000, #0d000, #0d000, #0d000, #0d000
	.db	#0d255, #0d255, #0d255, #0d064, #0d000, #0d000, #0d000, #0d000
	.db	#0d126, #0d033, #0d064, #0d035, #0d036, #0d037, #0d094, #0d038
	.db	#0d042, #0d040, #0d041, #0d095, #0d043, #0d008, #0d124, #0d000
	.db	#0d009, #0d081, #0d087, #0d069, #0d082, #0d084, #0d089, #0d085
	.db	#0d073, #0d079, #0d080, #0d123, #0d125, #0d058, #0d034, #0d013
	.db	#0d255, #0d065, #0d083, #0d068, #0d070, #0d071, #0d072, #0d074
	.db	#0d075, #0d076, #0d060, #0d062, #0d063, #0d000, #0d000, #0d000
	.db	#0d255, #0d090, #0d088, #0d067, #0d086, #0d066, #0d078, #0d077
	.db	#0d255, #0d255, #0d255, #0d032, #0d255, #0d255, #0d255, #0d000

