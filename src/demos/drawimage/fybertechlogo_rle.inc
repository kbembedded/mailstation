
	.db #0xff, #0x00, #0xaf, #0x00, #0x23, #0xff, #0x5d, #0x00
	.db #0x05, #0xff, #0x0a, #0x01, #0x05, #0xff, #0x0f, #0x01
	.db #0x5d, #0x00, #0x05, #0xff, #0x0a, #0x00, #0x05, #0x0f
	.db #0x6c, #0x00, #0x05, #0x01, #0x26, #0x00, #0x04, #0xf0
	.db #0x59, #0x00, #0x18, #0xff, #0x03, #0xf0, #0x08, #0x00
	.db #0x04, #0xff, #0x59, #0x00, #0x17, #0x80, #0x04, #0xff
	.db #0x04, #0xf0, #0x05, #0xff, #0x03, #0x0f, #0x59, #0x00
	.db #0x18, #0xff, #0x08, #0x0f, #0x58, #0x00, #0x23, #0x80
	.db #0x5d, #0x00, #0x23, #0xff, #0x65, #0x00, #0x04, #0xff
	.db #0x13, #0x80, #0x04, #0xff, #0x65, #0x00, #0x04, #0x0f
	.db #0x14, #0xff, #0x03, #0x0f, #0x69, #0x00, #0x14, #0x80
	.db #0x68, #0x00, #0x04, #0xf8, #0x07, #0x7f, #0x05, #0xff
	.db #0x07, #0x7f, #0x01, #0xff, #0x04, #0xf8, #0x64, #0x00
	.db #0x04, #0xff, #0x07, #0xc0, #0x05, #0xff, #0x07, #0x00
	.db #0x05, #0xff, #0x64, #0x00, #0x04, #0x07, #0x0c, #0x7f
	.db #0x07, #0x00, #0x05, #0x07, #0x64, #0x00, #0x1c, #0xc0
	.db #0x64, #0x00, #0x07, #0x7f, #0x05, #0xff, #0x10, #0x7f
	.db #0x64, #0x00, #0x04, #0xc0, #0x03, #0xfc, #0x01, #0xff
	.db #0x04, #0x07, #0x74, #0x00, #0x08, #0x7f, #0x78, #0x00
	.db #0x04, #0xc0, #0x74, #0x00, #0x08, #0xfc, #0x04, #0xff
	.db #0x14, #0xfc, #0x03, #0xe0, #0x5d, #0x00, #0x08, #0x03
	.db #0x04, #0xff, #0x13, #0x03, #0x04, #0xff, #0x65, #0x00
	.db #0x04, #0x3f, #0x13, #0x00, #0x04, #0x3f, #0x69, #0x00
	.db #0x13, #0xe0, #0x69, #0x00, #0x04, #0xfe, #0x07, #0x3f
	.db #0x05, #0xff, #0x07, #0x3f, #0x04, #0xfe, #0x65, #0x00
	.db #0x04, #0xff, #0x07, #0xe0, #0x05, #0xff, #0x07, #0x00
	.db #0x04, #0xff, #0x65, #0x00, #0x04, #0x03, #0x0c, #0x1f
	.db #0x07, #0x00, #0x04, #0x01, #0x69, #0x00, #0x14, #0xe0
	.db #0x68, #0x00, #0x04, #0xfe, #0x13, #0x1f, #0x01, #0xff
	.db #0x03, #0xfe, #0x65, #0x00, #0x04, #0xff, #0x04, #0xf0
	.db #0x0b, #0x00, #0x04, #0xf0, #0x04, #0xff, #0x65, #0x00
	.db #0x04, #0x01, #0x04, #0x1f, #0x0b, #0x00, #0x05, #0x1f
	.db #0x03, #0x01, #0x5d, #0x00, #0x23, #0xf0, #0x5d, #0x00
	.db #0x08, #0x1f, #0x04, #0xff, #0x17, #0x1f, #0x65, #0x00
	.db #0x04, #0xff, #0x17, #0xf0, #0x65, #0x00, #0x03, #0x01
	.db #0x18, #0x0f, #0xff, #0x00, #0x30, #0x00, #0x00, #0x00
