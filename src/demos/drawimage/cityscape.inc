
	.db #0x4a, #0x55, #0xa4, #0x29, #0x56, #0x92, #0xa9, #0x26
	.db #0x54, #0xa9, #0x4a, #0x92, #0xb5, #0x44, #0x2a, #0xa9
	.db #0x92, #0x4a, #0x95, #0x28, #0x52, #0xa5, #0x94, #0x4a
	.db #0x29, #0xa4, #0x92, #0x4a, #0x94, #0xa9, #0x12, #0xa4
	.db #0x49, #0x92, #0x2a, #0xa4, #0x12, #0x52, #0xa4, #0x09
	.db #0x32, #0xa4, #0x12, #0x4a, #0xa4, #0x11, #0x4b, #0x93
	.db #0x93, #0x4b, #0x13, #0x23, #0xbf, #0x3f, #0x3f, #0x3f
	.db #0xf7, #0xff, #0xbb, #0x57, #0xad, #0x19, #0x37, #0xad
	.db #0x1d, #0xa9, #0x6b, #0xdd, #0x92, #0x0d, #0x2d, #0x52
	.db #0xad, #0x55, #0x0a, #0x8d, #0x52, #0x2a, #0x8d, #0x96
	.db #0x11, #0x8e, #0x45, #0x8a, #0x45, #0x5a, #0x85, #0xd6
	.db #0x0a, #0xc7, #0xd6, #0x28, #0x47, #0xcd, #0x1a, #0x76
	.db #0x89, #0x3c, #0x6e, #0x5f, #0x8b, #0x77, #0x7a, #0x00
	.db #0x00, #0x00, #0x03, #0x5f, #0xff, #0xfb, #0x00, #0xdf
	.db #0xff, #0x00, #0x01, #0x07, #0x1a, #0x05, #0x2b, #0x15
	.db #0x25, #0x0b, #0x16, #0x49, #0x0b, #0x1d, #0x53, #0x0d
	.db #0x92, #0x25, #0xaa, #0x49, #0x52, #0x96, #0x28, #0xa5
	.db #0x4b, #0x98, #0x52, #0x8a, #0xa4, #0xf5, #0x69, #0x92
	.db #0x64, #0xb5, #0xaa, #0x71, #0x0a, #0xb4, #0xba, #0x52
	.db #0xd9, #0xda, #0x34, #0x6a, #0xb4, #0xda, #0x69, #0xec
	.db #0x5a, #0xb4, #0x19, #0xfa, #0xd5, #0xac, #0x72, #0x6d
	.db #0xad, #0xf4, #0x6d, #0xcc, #0xbc, #0x75, #0xa6, #0xdc
	.db #0x76, #0xda, #0x6d, #0xde, #0xba, #0x76, #0xed, #0xd6
	.db #0xbb, #0x77, #0x4d, #0xbf, #0xf2, #0x69, #0xc9, #0xb7
	.db #0xda, #0x35, #0x6a, #0xf6, #0xa5, #0x7a, #0xd3, #0xed
	.db #0xb2, #0x6b, #0xf5, #0x79, #0xb3, #0xf4, #0x75, #0xfb
	.db #0xe4, #0xb3, #0xfb, #0xb4, #0xf3, #0xd5, #0xda, #0xb1
	.db #0x8a, #0x48, #0x01, #0x82, #0x00, #0x00, #0x01, #0x09
	.db #0x00, #0x04, #0x01, #0x2a, #0x44, #0x00, #0x03, #0x00
	.db #0x00, #0x00, #0x00, #0x00, #0xff, #0x8b, #0x00, #0xff
	.db #0xbf, #0x00, #0x00, #0x00, #0x00, #0x00, #0x00, #0x00
	.db #0x00, #0x00, #0x00, #0x00, #0x00, #0x00, #0x00, #0x00
	.db #0x08, #0xd5, #0x22, #0x4a, #0x49, #0x94, #0x29, #0x52
	.db #0x4a, #0xa4, #0xe9, #0x5e, #0xb5, #0xd6, #0x6b, #0xb6
	.db #0x4d, #0x2d, #0xf2, #0x8b, #0x9d, #0x7a, #0x65, #0xdb
	.db #0xb6, #0x56, #0x6c, #0xb9, #0xdb, #0xd7, #0x2a, #0xd5
	.db #0x77, #0x96, #0x7a, #0x2b, #0xf6, #0x6d, #0xcb, #0xbf
	.db #0x59, #0xf6, #0x59, #0xe7, #0xaa, #0xdf, #0xb9, #0xcb
	.db #0xfe, #0x95, #0xfe, #0xeb, #0x4d, #0xb7, #0xfe, #0xea
	.db #0x97, #0x25, #0xea, #0xdf, #0x5a, #0xeb, #0xdd, #0xd6
	.db #0x6c, #0xeb, #0x59, #0xdb, #0x26, #0xdf, #0x9a, #0xb7
	.db #0x4e, #0xad, #0xdb, #0x5b, #0xed, #0xd6, #0xae, #0x5b
	.db #0xed, #0xba, #0x77, #0x6f, #0xca, #0x85, #0xef, #0x6a
	.db #0xd2, #0xb5, #0xa8, #0x40, #0xb0, #0xd8, #0xf0, #0xf0
	.db #0xac, #0x40, #0x48, #0xaa, #0xaa, #0x9a, #0xaf, #0x1a
	.db #0x00, #0x00, #0x40, #0xf8, #0x85, #0x08, #0x00, #0xff
	.db #0xff, #0x00, #0x00, #0x00, #0x00, #0x00, #0x20, #0x00
	.db #0xa0, #0x40, #0x00, #0x20, #0x40, #0x10, #0x80, #0x20
	.db #0x00, #0x96, #0x29, #0x40, #0x2b, #0x44, #0x94, #0x9b
	.db #0x76, #0xee, #0xbd, #0xfb, #0x86, #0xde, #0xfd, #0x6a
	.db #0xf7, #0xcf, #0xcc, #0x7f, #0xe6, #0xbf, #0xfb, #0x9e
	.db #0x37, #0xfb, #0xdf, #0xfd, #0xb6, #0xff, #0x9b, #0xfd
	.db #0xef, #0xb7, #0xf7, #0x6c, #0xff, #0xb7, #0x7d, #0xef
	.db #0xbb, #0xff, #0x4b, #0x8f, #0xfe, #0xfd, #0x73, #0xde
	.db #0xff, #0xdb, #0xbe, #0xf5, #0x6f, #0xbf, #0xf0, #0xdf
	.db #0xbf, #0xf0, #0x87, #0x7f, #0xdd, #0x1b, #0xee, #0xfd
	.db #0xb7, #0xdb, #0xf7, #0xbe, #0xd9, #0xed, #0x15, #0xff
	.db #0x7a, #0xeb, #0xb5, #0x7b, #0xe6, #0xee, #0x5d, #0xf6
	.db #0xb6, #0x76, #0xd8, #0xbb, #0x77, #0xd6, #0x2d, #0x7d
	.db #0xe6, #0xca, #0xfd, #0xea, #0xfb, #0xff, #0xfe, #0xff
	.db #0x7b, #0xfa, #0xf2, #0xed, #0xfa, #0xee, #0xfd, #0xdd
	.db #0x00, #0x00, #0x29, #0xff, #0xfe, #0x00, #0x00, #0xff
	.db #0xdf, #0x00, #0x00, #0x00, #0x00, #0x00, #0x01, #0x00
	.db #0x08, #0x00, #0x01, #0x12, #0x00, #0x00, #0x04, #0x21
	.db #0x00, #0x20, #0xb5, #0x42, #0x68, #0xe5, #0xd0, #0x4a
	.db #0xb5, #0x7a, #0xe7, #0xf7, #0xb5, #0xf7, #0xbe, #0xf3
	.db #0xdf, #0xe6, #0xbd, #0xfb, #0xce, #0x7c, #0xff, #0xcb
	.db #0xdf, #0xef, #0xfe, #0x5d, #0xef, #0xfd, #0xcf, #0xfe
	.db #0xfd, #0xf7, #0xdf, #0x75, #0xff, #0xdf, #0x7b, #0xff
	.db #0xed, #0x9f, #0xf7, #0x7f, #0x9d, #0xfe, #0xff, #0xf7
	.db #0x6e, #0xd9, #0xf7, #0xff, #0xff, #0xbb, #0xdf, #0xee
	.db #0xff, #0xfd, #0xdc, #0xff, #0xff, #0xb7, #0xff, #0xfb
	.db #0xdf, #0xfd, #0x7f, #0xf7, #0xbe, #0x45, #0xfd, #0xfe
	.db #0x56, #0xff, #0xbb, #0xd7, #0xe6, #0xdf, #0xbd, #0x76
	.db #0xff, #0xbd, #0xfb, #0xdf, #0xff, #0xfb, #0xaf, #0xde
	.db #0xff, #0xdf, #0xff, #0xff, #0xff, #0xfb, #0xff, #0x7f
	.db #0xff, #0xff, #0x6f, #0xff, #0x7f, #0x6d, #0x7f, #0xfd
	.db #0x01, #0x00, #0x95, #0xff, #0xf7, #0x00, #0x40, #0xff
	.db #0x96, #0x00, #0x00, #0x00, #0x00, #0x00, #0x00, #0x00
	.db #0x00, #0x00, #0x00, #0x00, #0x00, #0x00, #0x00, #0x01
	.db #0x00, #0x51, #0xb6, #0xcd, #0x59, #0x66, #0x5e, #0xfb
	.db #0x57, #0xfb, #0xee, #0x77, #0xfe, #0xed, #0xdb, #0xff
	.db #0x76, #0xfd, #0xee, #0x77, #0xfd, #0xff, #0xb6, #0xef
	.db #0x96, #0x7d, #0xfd, #0xff, #0xfb, #0xdf, #0x7e, #0x76
	.db #0xff, #0xfd, #0xfb, #0xfb, #0xdf, #0x99, #0x7f, #0xf7
	.db #0xff, #0xfd, #0xf7, #0xff, #0xfb, #0xdc, #0xff, #0xff
	.db #0xff, #0xfb, #0xff, #0xdf, #0xfd, #0xff, #0xef, #0xfd
	.db #0xff, #0xff, #0x7e, #0xf7, #0xff, #0xee, #0xff, #0xbf
	.db #0xf6, #0xff, #0xff, #0xbf, #0x41, #0xfe, #0xff, #0xdb
	.db #0xef, #0xfe, #0xb5, #0xef, #0xfe, #0xb5, #0xdb, #0xff
	.db #0xd2, #0x95, #0xde, #0xfb, #0xed, #0xbf, #0xf7, #0x7f
	.db #0xf6, #0x23, #0xff, #0xff, #0xdb, #0xff, #0xff, #0xf7
	.db #0xa9, #0xe3, #0x61, #0xe1, #0x3b, #0x3f, #0xb5, #0xaf
	.db #0x08, #0x02, #0x00, #0xff, #0xff, #0x12, #0xed, #0xff
	.db #0x00, #0x00, #0x00, #0x00, #0x00, #0x00, #0x00, #0x00
	.db #0x00, #0x00, #0x00, #0x00, #0x00, #0x00, #0x00, #0x00
	.db #0x00, #0x62, #0xb9, #0xd6, #0x7b, #0xb7, #0xed, #0xf6
	.db #0x67, #0xff, #0xee, #0xbb, #0xff, #0xd7, #0x9e, #0xd5
	.db #0xbf, #0xff, #0xf7, #0xff, #0xef, #0xed, #0xff, #0xfd
	.db #0xed, #0xfb, #0xef, #0xff, #0xf7, #0xfb, #0xff, #0xe9
	.db #0xf7, #0xff, #0xbf, #0xf1, #0xff, #0xdf, #0xff, #0xff
	.db #0xff, #0xff, #0xee, #0xff, #0xcf, #0xfb, #0xfe, #0xff
	.db #0xf6, #0xfd, #0xdf, #0xff, #0xff, #0xff, #0xfe, #0xf7
	.db #0xff, #0xff, #0xff, #0xff, #0xef, #0xfd, #0xff, #0xff
	.db #0xfb, #0xff, #0xff, #0xd2, #0xfd, #0xff, #0xff, #0xbf
	.db #0xff, #0xfd, #0xdf, #0xff, #0xff, #0xed, #0xff, #0x7f
	.db #0xbd, #0xff, #0xf7, #0xbe, #0xfb, #0xdf, #0xfe, #0xff
	.db #0xdb, #0xfd, #0x6f, #0xfb, #0xde, #0x9f, #0x3f, #0x0d
	.db #0x09, #0x13, #0xbf, #0xec, #0x58, #0x89, #0xff, #0x77
	.db #0x4a, #0x09, #0x00, #0x23, #0xff, #0x00, #0x25, #0xff
	.db #0x00, #0x00, #0x00, #0x00, #0x00, #0x00, #0x00, #0x00
	.db #0x00, #0x00, #0x00, #0x00, #0x00, #0x00, #0x00, #0x00
	.db #0x00, #0xa0, #0x44, #0x08, #0x52, #0xa0, #0x0a, #0x24
	.db #0x50, #0x4a, #0x24, #0xa4, #0x44, #0x2a, #0x90, #0xa4
	.db #0x4a, #0x94, #0x24, #0x52, #0xa4, #0x24, #0x4a, #0x94
	.db #0x28, #0x52, #0xa4, #0x24, #0x4a, #0x94, #0x50, #0x4a
	.db #0xa4, #0x14, #0x52, #0xa4, #0x0a, #0x50, #0xaa, #0x84
	.db #0x54, #0x22, #0xa4, #0x14, #0x22, #0xa4, #0x94, #0x22
	.db #0x24, #0x94, #0x22, #0x24, #0x44, #0x4a, #0x90, #0x12
	.db #0x24, #0xa4, #0xd2, #0xc8, #0x64, #0xf1, #0xd4, #0xac
	.db #0xb8, #0x99, #0xfe, #0xff, #0xf7, #0xfb, #0xff, #0xff
	.db #0xfb, #0xff, #0xf7, #0x7f, #0xfe, #0xf7, #0xff, #0xff
	.db #0x77, #0xff, #0xf7, #0xfd, #0xff, #0xf7, #0xfe, #0xf7
	.db #0x7e, #0xfb, #0xed, #0x7e, #0xda, #0xf4, #0x46, #0x80
	.db #0x60, #0x4d, #0x1b, #0x35, #0x25, #0x05, #0x37, #0xa3
	.db #0x4a, #0x01, #0x00, #0x80, #0x92, #0x00, #0x49, #0xff
	.db #0x00, #0x00, #0x00, #0x00, #0x00, #0x00, #0x00, #0x00
	.db #0x00, #0x00, #0x00, #0x00, #0x00, #0x00, #0x00, #0x00
	.db #0x90, #0x25, #0x4a, #0xa8, #0x25, #0x94, #0x49, #0x29
	.db #0x92, #0x25, #0xaa, #0x44, #0x29, #0x52, #0xa4, #0x4a
	.db #0x94, #0x52, #0x25, #0xca, #0x94, #0x29, #0x52, #0x4a
	.db #0x49, #0x92, #0xaa, #0x25, #0x54, #0x22, #0xa5, #0x54
	.db #0x22, #0x95, #0x52, #0x24, #0x49, #0x92, #0x24, #0x4a
	.db #0x94, #0x21, #0x4a, #0xa9, #0x12, #0xa4, #0x24, #0x49
	.db #0x89, #0x94, #0x51, #0x8b, #0x5e, #0xb8, #0x5b, #0xfb
	.db #0x6d, #0x9e, #0x95, #0xdd, #0x4f, #0x3e, #0x8d, #0xdd
	.db #0x4a, #0xee, #0x3c, #0xdb, #0xff, #0xff, #0xff, #0xff
	.db #0xf7, #0xe7, #0xff, #0xff, #0xff, #0xff, #0xff, #0x9f
	.db #0xff, #0xf7, #0xff, #0xff, #0xff, #0xfe, #0xef, #0xff
	.db #0xff, #0xfb, #0xdf, #0xff, #0xfb, #0xf7, #0xdf, #0xfa
	.db #0xf8, #0x60, #0xb0, #0xf8, #0x50, #0x84, #0x61, #0x58
	.db #0xb3, #0x20, #0x00, #0xf6, #0xe9, #0x00, #0x00, #0xff
	.db #0xa0, #0x00, #0x20, #0xa0, #0x50, #0x20, #0xa0, #0x50
	.db #0xc8, #0x20, #0x40, #0xa8, #0x40, #0x00, #0xa8, #0x00
	.db #0x24, #0xa9, #0x55, #0x92, #0x29, #0x54, #0xa5, #0x49
	.db #0x5a, #0x91, #0xaa, #0x52, #0x25, #0xa9, #0x4a, #0x94
	.db #0xb2, #0x45, #0x2a, #0xd4, #0x92, #0x25, #0xaa, #0x49
	.db #0x92, #0x2a, #0x54, #0x49, #0xa5, #0x4a, #0x94, #0xa9
	.db #0x49, #0x92, #0x2a, #0x51, #0x8a, #0x24, #0xa9, #0x45
	.db #0x94, #0x29, #0x22, #0x54, #0x89, #0x52, #0x89, #0x24
	.db #0x52, #0xa4, #0xd2, #0xcc, #0xbb, #0x6d, #0xdb, #0xd6
	.db #0x4f, #0xe9, #0x99, #0xbf, #0x77, #0x2b, #0xdd, #0xf7
	.db #0x6b, #0xb7, #0x6f, #0xf0, #0xb7, #0xdf, #0xba, #0x75
	.db #0xef, #0xb6, #0x6a, #0xb7, #0xf5, #0xa5, #0x85, #0xdb
	.db #0xab, #0x34, #0xe9, #0xad, #0x32, #0x6b, #0x24, #0x91
	.db #0x22, #0x6e, #0x90, #0x28, #0x33, #0x48, #0x22, #0xff
	.db #0xff, #0x81, #0x91, #0x70, #0x60, #0x00, #0x11, #0xfd
	.db #0x68, #0x44, #0x00, #0xdf, #0xf6, #0x00, #0xd0, #0xff
	.db #0x20, #0xd5, #0xaa, #0x50, #0xb5, #0xed, #0x52, #0xa8
	.db #0xf6, #0x49, #0xb4, #0xe9, #0x4a, #0xb5, #0xc8, #0x29
	.db #0x55, #0xaa, #0x49, #0x5a, #0xa5, #0x29, #0x5a, #0x92
	.db #0x55, #0xaa, #0x94, #0x65, #0x29, #0x96, #0x69, #0x24
	.db #0x4a, #0xb5, #0x92, #0x24, #0x6a, #0x95, #0x24, #0xa9
	.db #0x4a, #0x95, #0x52, #0xa9, #0x4a, #0x92, #0x54, #0xaa
	.db #0x12, #0x64, #0x49, #0x95, #0x24, #0xa9, #0x92, #0x24
	.db #0x4a, #0xa9, #0x91, #0x26, #0x24, #0x49, #0x54, #0x89
	.db #0x92, #0x5f, #0x9f, #0x5e, #0xfd, #0xe5, #0x3e, #0xbe
	.db #0xf5, #0xe6, #0x7f, #0x7d, #0xef, #0xf4, #0xbe, #0xbd
	.db #0x76, #0xc4, #0xbf, #0xfe, #0xed, #0x7f, #0xec, #0xfd
	.db #0xd7, #0xfe, #0xbd, #0xe0, #0xff, #0xbd, #0xcc, #0xbe
	.db #0x65, #0x69, #0xb2, #0xf7, #0x2a, #0xb5, #0x92, #0x75
	.db #0xb5, #0xa2, #0x54, #0x35, #0x82, #0x65, #0x12, #0xf2
	.db #0x8f, #0x0f, #0x8b, #0xaf, #0xfa, #0xd7, #0x6f, #0xff
	.db #0xd5, #0xb1, #0x00, #0x06, #0x5a, #0x00, #0xff, #0x81
	.db #0x01, #0x6e, #0xa5, #0xdb, #0x06, #0xb5, #0x4b, #0xa5
	.db #0x46, #0x5b, #0xb5, #0x4a, #0xab, #0x55, #0x6a, #0xdb
	.db #0x55, #0xaa, #0x55, #0xaa, #0x55, #0xa9, #0x4b, #0xb4
	.db #0x25, #0x6a, #0x94, #0xab, #0x69, #0x92, #0x2d, #0xc9
	.db #0x52, #0xad, #0x24, #0xa9, #0x5b, #0x24, #0xc9, #0x9a
	.db #0x25, #0xd4, #0x4a, #0x92, #0xb5, #0x44, #0x29, #0x5a
	.db #0x45, #0x92, #0x69, #0x4a, #0x95, #0xa8, #0x12, #0xa5
	.db #0x2a, #0x54, #0xa2, #0x15, #0xa9, #0x92, #0x25, #0x48
	.db #0x92, #0x2a, #0xa4, #0x92, #0x4b, #0x97, #0x25, #0x27
	.db #0xd7, #0xa6, #0x87, #0x52, #0xa6, #0x97, #0xa5, #0xa7
	.db #0x97, #0xa3, #0x95, #0xa7, #0xc7, #0x27, #0xd3, #0xfe
	.db #0xf7, #0xff, #0x6d, #0x7d, #0xfb, #0xd7, #0x7b, #0x95
	.db #0xf9, #0x0f, #0x26, #0xfd, #0x3b, #0xd6, #0x37, #0xed
	.db #0x1a, #0x7b, #0x44, #0x2f, #0xf8, #0x05, #0x03, #0xb4
	.db #0x67, #0x58, #0x4d, #0x1d, #0x0d, #0x05, #0x0d, #0x45
	.db #0xad, #0x6c, #0x00, #0x68, #0x45, #0x00, #0xff, #0x14
	.db #0xed, #0xbb, #0x56, #0xee, #0x2d, #0xab, #0x4d, #0xb6
	.db #0x5b, #0xab, #0xde, #0x55, #0xab, #0xb6, #0x6d, #0x6b
	.db #0x55, #0xaa, #0x55, #0xaa, #0x55, #0xaa, #0x55, #0xaa
	.db #0x55, #0xa9, #0x56, #0xa4, #0xad, #0x52, #0x55, #0xaa
	.db #0x52, #0xad, #0x49, #0x5a, #0xa5, #0x29, #0xda, #0x24
	.db #0x55, #0xaa, #0x52, #0x94, #0x2d, #0x52, #0xa9, #0x95
	.db #0xaa, #0x52, #0x25, #0xaa, #0x54, #0x49, #0x95, #0x64
	.db #0x49, #0x95, #0xaa, #0x24, #0x49, #0xd4, #0x89, #0x52
	.db #0xaa, #0x49, #0x14, #0x62, #0xca, #0x94, #0x0d, #0xfa
	.db #0xff, #0xf7, #0xda, #0xfc, #0xd7, #0xdb, #0x7e, #0x95
	.db #0xff, #0x2d, #0xdd, #0xee, #0x5b, #0xdd, #0xbd, #0x52
	.db #0xdf, #0xbd, #0x6d, #0xdf, #0x59, #0xef, #0xc5, #0x3e
	.db #0xed, #0x5b, #0xae, #0x6d, #0x5f, #0xc9, #0x5b, #0xbd
	.db #0x83, #0x5f, #0xb9, #0x4b, #0x2e, #0x51, #0x25, #0x4c
	.db #0x05, #0x8b, #0x0f, #0x08, #0x04, #0x57, #0xa2, #0x04
	.db #0x01, #0x82, #0x04, #0x09, #0x93, #0x00, #0xff, #0x04
	.db #0x8b, #0xdf, #0x02, #0x7f, #0x45, #0x9b, #0x27, #0x8a
	.db #0x4b, #0x5d, #0xd6, #0x8b, #0x36, #0xed, #0x4b, #0xb7
	.db #0x6d, #0x92, #0x6d, #0xaa, #0x55, #0xaa, #0x55, #0xaa
	.db #0x55, #0xaa, #0x55, #0xaa, #0xaa, #0x55, #0xa9, #0x56
	.db #0xa9, #0xaa, #0x55, #0xa5, #0x5a, #0xa9, #0x26, #0xd9
	.db #0x49, #0x96, #0xb2, #0xa5, #0x4d, #0x32, #0xca, #0x94
	.db #0x35, #0xa2, #0x4d, #0xb2, #0x49, #0x96, #0x28, #0x53
	.db #0xaa, #0x24, #0x4a, #0xd5, #0x92, #0x24, #0xaa, #0x54
	.db #0x22, #0x95, #0x2a, #0x51, #0x4b, #0xbd, #0xf6, #0xff
	.db #0x7f, #0x6d, #0xb6, #0x6f, #0xda, #0xf7, #0x0d, #0xfa
	.db #0x57, #0xad, #0x6e, #0xda, #0x37, #0x6e, #0xd5, #0x2f
	.db #0xdc, #0xab, #0x5e, #0x34, #0xed, #0x5a, #0xb7, #0x6d
	.db #0x56, #0xbf, #0xa4, #0x5d, #0xdb, #0x26, #0x74, #0x4d
	.db #0x96, #0x35, #0xac, #0x51, #0x13, #0x6c, #0x95, #0xb7
	.db #0x24, #0x54, #0x50, #0xb8, #0x61, #0xd0, #0xa0, #0x60
	.db #0x54, #0x90, #0x20, #0x50, #0x20, #0x00, #0xff, #0xf0
	.db #0xaa, #0xde, #0xb1, #0xb5, #0x6a, #0xd9, #0xb4, #0xb0
	.db #0x6b, #0xd4, #0xb6, #0x68, #0xd5, #0x6e, #0xb9, #0xdb
	.db #0xdb, #0xaa, #0x55, #0xb6, #0xa9, #0x55, #0xb6, #0x49
	.db #0xdb, #0x94, #0x6b, #0x54, #0x95, #0x6a, #0x55, #0xaa
	.db #0xaa, #0x55, #0xaa, #0xaa, #0x55, #0xaa, #0x55, #0xaa
	.db #0xa5, #0x54, #0xaa, #0x55, #0xaa, #0x55, #0xaa, #0xa4
	.db #0x55, #0xaa, #0x55, #0x4a, #0xa9, #0x5a, #0x45, #0xa9
	.db #0x5a, #0x45, #0xb2, #0x24, #0x4a, #0xd5, #0x24, #0x29
	.db #0xd5, #0x12, #0x49, #0xa2, #0x41, #0x82, #0x3b, #0xbd
	.db #0x23, #0x43, #0xc1, #0xff, #0xfe, #0xed, #0x7b, #0xf7
	.db #0xda, #0xff, #0xbb, #0xe6, #0x7d, #0xdb, #0xff, #0xb1
	.db #0x77, #0xfe, #0xa3, #0x41, #0xff, #0xff, #0x80, #0xdb
	.db #0x7f, #0xe5, #0xbe, #0x53, #0x6e, #0x6b, #0x77, #0xc9
	.db #0x5b, #0x40, #0x4b, #0xff, #0x91, #0x7f, #0x40, #0xb7
	.db #0x29, #0x65, #0x82, #0x01, #0x81, #0x40, #0x21, #0x03
	.db #0x00, #0x00, #0x00, #0x90, #0x09, #0x40, #0xff, #0x00
	.db #0x65, #0xca, #0x81, #0x7d, #0xa1, #0x82, #0x91, #0x44
	.db #0x41, #0xb6, #0x80, #0x41, #0xb6, #0xcb, #0xa9, #0x56
	.db #0xb6, #0xaa, #0x55, #0x6d, #0xaa, #0x55, #0xda, #0xa5
	.db #0xb6, #0x4a, #0xb5, #0xad, #0x52, #0xab, #0xb5, #0x4a
	.db #0x5a, #0xa5, #0x5a, #0xaa, #0x55, #0xaa, #0x55, #0xaa
	.db #0xaa, #0x55, #0xaa, #0x55, #0xaa, #0x55, #0xa4, #0x9a
	.db #0x55, #0x52, #0xa6, #0x59, #0xaa, #0x25, #0x5a, #0x52
	.db #0xa5, #0x5a, #0x92, #0xa5, #0x5a, #0x24, #0xa5, #0x59
	.db #0x8a, #0x55, #0x52, #0x4a, #0xa9, #0x94, #0x49, #0x92
	.db #0x35, #0x22, #0x54, #0x4a, #0xa4, #0x12, #0x55, #0xa9
	.db #0x49, #0x92, #0x65, #0xf9, #0xfb, #0xff, #0x7e, #0xad
	.db #0xff, #0xfe, #0xdb, #0xff, #0xee, #0xb7, #0xfe, #0xfd
	.db #0xaf, #0xfe, #0x7b, #0xb7, #0xdf, #0xfb, #0xb7, #0xfe
	.db #0xdb, #0xb6, #0xff, #0xaa, #0xf6, #0x9f, #0xf2, #0xae
	.db #0x55, #0xaa, #0x80, #0x11, #0x00, #0x80, #0x82, #0x80
	.db #0x02, #0x0c, #0x20, #0x00, #0x0d, #0x40, #0x2b, #0xd2
	.db #0xff, #0x92, #0xea, #0xbf, #0x75, #0xd2, #0xd6, #0xad
	.db #0x75, #0xda, #0xd2, #0xbd, #0x76, #0xd6, #0xed, #0xbb
	.db #0x6d, #0xda, #0x95, #0x6b, #0xb6, #0x55, #0xaa, #0xb6
	.db #0x55, #0xaa, #0xb5, #0x6a, #0x95, #0xda, #0xa5, #0xb6
	.db #0x29, #0x6d, #0xca, #0x35, #0xd5, #0x2a, #0xd5, #0xaa
	.db #0x2a, #0xd5, #0xaa, #0x55, #0xaa, #0x55, #0xaa, #0x54
	.db #0xab, #0x55, #0xa4, #0x2b, #0x54, #0xa5, #0x5b, #0x92
	.db #0x54, #0xab, #0x54, #0x92, #0xad, #0x51, #0x4a, #0x35
	.db #0xa4, #0x49, #0x56, #0xa9, #0x92, #0x54, #0x25, #0x4a
	.db #0xa9, #0x15, #0x52, #0xa9, #0x92, #0x25, #0xaa, #0x54
	.db #0x21, #0x96, #0xa8, #0x45, #0x2f, #0xff, #0xff, #0x3b
	.db #0x37, #0xff, #0xd6, #0xed, #0x3f, #0x7b, #0xfd, #0x6f
	.db #0xff, #0xfb, #0xcf, #0xff, #0xdb, #0xff, #0x2d, #0xff
	.db #0xf7, #0xb6, #0xbb, #0xfd, #0x4b, #0x74, #0xbd, #0xef
	.db #0xd1, #0x2d, #0x84, #0x88, #0x00, #0x81, #0x50, #0x2a
	.db #0x04, #0x50, #0x00, #0x20, #0xc0, #0x2f, #0x48, #0xff
	.db #0xdb, #0x24, #0xff, #0xfb, #0x4d, #0xb6, #0xea, #0xad
	.db #0x77, #0xee, #0xaa, #0x77, #0xff, #0xaa, #0xdd, #0x7f
	.db #0xdb, #0xb6, #0x54, #0xab, #0x5d, #0xb5, #0xca, #0xad
	.db #0xb5, #0x6a, #0x4d, #0xb5, #0xaa, #0x56, #0xb4, #0x4d
	.db #0x6b, #0xd5, #0x2a, #0xd5, #0xaa, #0x55, #0xaa, #0x56
	.db #0x69, #0x96, #0x6a, #0x95, #0x6a, #0x95, #0x6a, #0x95
	.db #0xaa, #0x55, #0x54, #0xab, #0x49, #0xb6, #0x49, #0xaa
	.db #0x55, #0xaa, #0x49, #0x56, #0xa4, #0x59, #0x4b, #0x52
	.db #0x94, #0xab, #0x52, #0xa4, #0x4d, #0x52, #0xa9, #0x25
	.db #0x4a, #0x59, #0xa2, #0x96, #0x28, #0xa5, #0x4a, #0x52
	.db #0xa5, #0x94, #0x52, #0x8a, #0x29, #0x52, #0xa5, #0x1f
	.db #0x7b, #0x6f, #0xff, #0xbd, #0xbe, #0xf7, #0xbb, #0xff
	.db #0xff, #0xe9, #0x73, #0xff, #0xee, #0xed, #0xbf, #0xbb
	.db #0xf7, #0xef, #0xec, #0xfb, #0xde, #0x64, #0xd7, #0xed
	.db #0xd2, #0xcd, #0xd9, #0x52, #0x80, #0x00, #0x00, #0x58
	.db #0x02, #0x82, #0x00, #0x24, #0x00, #0xff, #0x48, #0xbf
	.db #0xf5, #0x4a, #0xff, #0x6d, #0xb5, #0xb6, #0x6a, #0xad
	.db #0x7b, #0xd6, #0xbd, #0xfb, #0xd6, #0x6f, #0xfd, #0xab
	.db #0xb6, #0x6d, #0xa9, #0xd7, #0x5a, #0xb5, #0x66, #0x5a
	.db #0xb5, #0x66, #0xad, #0xd5, #0x5a, #0xb5, #0xa5, #0x5b
	.db #0xaa, #0xd6, #0xb5, #0x4a, #0xb6, #0x69, #0x96, #0xb5
	.db #0x65, #0x9a, #0xd5, #0x2a, #0xb5, #0xca, #0x2d, #0xb2
	.db #0x56, #0x29, #0xd5, #0xaa, #0x55, #0xaa, #0x55, #0xaa
	.db #0x55, #0xa4, #0xab, #0x5a, #0x24, #0xab, #0x52, #0x95
	.db #0xaa, #0x54, #0x25, #0xaa, #0x52, #0x95, #0xaa, #0x49
	.db #0x52, #0xad, #0x44, #0x2a, #0xa9, #0x52, #0x4a, #0x95
	.db #0xa8, #0x12, #0x55, #0xa4, #0x49, #0x9a, #0x00, #0x54
	.db #0x64, #0xbb, #0xb7, #0xab, #0xb6, #0xbf, #0xeb, #0xb7
	.db #0xbb, #0xbb, #0xb7, #0xab, #0xbb, #0xb3, #0xaf, #0xbb
	.db #0xb3, #0x27, #0xfd, #0x23, #0xb7, #0x0b, #0xb3, #0x27
	.db #0x32, #0x23, #0x33, #0x22, #0x02, #0x02, #0x00, #0x02
	.db #0x81, #0x00, #0x00, #0x95, #0x00, #0xff, #0xf7, #0xad
	.db #0xde, #0x6b, #0xff, #0x5b, #0xb6, #0x6d, #0xeb, #0xd7
	.db #0xbd, #0xee, #0x77, #0xde, #0xfd, #0xb7, #0xdb, #0xfd
	.db #0xed, #0x5b, #0xaa, #0xb6, #0x6d, #0xd5, #0xab, #0xb6
	.db #0x6d, #0x49, #0xb6, #0xb6, #0x55, #0xaa, #0x6d, #0xd5
	.db #0x9a, #0xb6, #0x52, #0xad, #0x5a, #0xd3, #0xb6, #0x4c
	.db #0xb3, #0x6a, #0x96, #0xb5, #0x4a, #0xda, #0x95, #0x69
	.db #0xab, #0x55, #0x54, #0xaa, #0x55, #0xaa, #0x55, #0xaa
	.db #0x55, #0xaa, #0x54, #0xab, #0x55, #0xa4, #0x2b, #0xd4
	.db #0x2a, #0xa5, #0x59, #0x92, #0x65, #0x9a, #0xa4, #0x55
	.db #0x2a, #0x52, #0xa5, #0x99, #0x52, #0xa5, #0x2a, #0x54
	.db #0x49, #0x95, #0x52, #0xaa, #0x49, #0x24, #0x95, #0x52
	.db #0x49, #0x2f, #0x9e, #0x4f, #0x97, #0x9d, #0x57, #0x4f
	.db #0x2d, #0x9d, #0x4f, #0xfd, #0x6d, #0x37, #0xed, #0xed
	.db #0x5d, #0x77, #0x6d, #0xd5, #0xfd, #0x6d, #0xf5, #0xdd
	.db #0x35, #0x55, #0x9d, #0x35, #0x01, #0x10, #0x00, #0x00
	.db #0x80, #0x45, #0x00, #0x10, #0x80, #0xff, #0xbf, #0xda
	.db #0x6d, #0xbb, #0xdf, #0xed, #0xbb, #0xdb, #0xb6, #0x6e
	.db #0x7d, #0xdb, #0xef, #0x7e, #0xdb, #0xff, #0xb6, #0x6d
	.db #0xee, #0x55, #0x6d, #0xda, #0xab, #0xb6, #0x5a, #0xd5
	.db #0xab, #0xb6, #0x55, #0xed, #0x95, #0xba, #0x6b, #0x56
	.db #0xb4, #0x4d, #0x6b, #0xda, #0x95, #0x6a, #0xd6, #0x95
	.db #0xba, #0x65, #0x4d, #0xda, #0x55, #0xaa, #0x6a, #0x55
	.db #0xaa, #0x55, #0xab, #0xb4, #0x4b, #0x5a, #0xa5, #0x6a
	.db #0x95, #0x6a, #0x95, #0x6a, #0x95, #0x6a, #0xa5, #0x94
	.db #0x6b, #0x94, #0x55, #0xaa, #0x25, #0xd4, #0x2a, #0x55
	.db #0xc9, #0x2a, #0x55, #0xa4, #0x4a, #0x59, #0xa5, #0x4a
	.db #0xa9, #0x52, #0x26, #0x54, #0xc9, #0x95, #0x52, #0xaa
	.db #0x11, #0xa5, #0x4c, #0x91, #0x2a, #0xa4, #0x92, #0x29
	.db #0x25, #0x54, #0x22, #0x4b, #0x93, #0x2c, #0x47, #0xab
	.db #0x4f, #0x87, #0x2e, #0x93, #0x4d, #0x6b, #0x77, #0x8c
	.db #0x29, #0xff, #0xd2, #0xc5, #0xb4, #0x10, #0x20, #0x00
	.db #0x01, #0x00, #0x00, #0x80, #0xde, #0xb5, #0xfb, #0x7f
	.db #0x52, #0xbf, #0xfd, #0xeb, #0x5e, #0xf5, #0xdb, #0x6f
	.db #0xfd, #0xdb, #0xef, #0x7f, #0xfa, #0xb7, #0xff, #0xdb
	.db #0xee, #0x55, #0xbb, #0xd6, #0xaa, #0x5d, #0x6b, #0xda
	.db #0x55, #0xb6, #0x6d, #0xaa, #0xd5, #0x6e, #0x55, #0xab
	.db #0xda, #0xb5, #0x2b, #0xf6, #0x94, #0xab, #0x76, #0x94
	.db #0x6d, #0xab, #0x52, #0x6e, #0xd5, #0x2a, #0xd5, #0xab
	.db #0x6c, #0x53, #0xd6, #0xac, #0x53, #0xad, #0x6a, #0x95
	.db #0x6a, #0x95, #0x6a, #0x55, #0xaa, #0x55, #0xaa, #0x54
	.db #0xab, #0x54, #0xa5, #0x5a, #0xa5, #0x2a, #0xd5, #0x2a
	.db #0x52, #0xd5, #0x4a, #0x29, #0x56, #0xa9, #0x92, #0x56
	.db #0xa4, #0x29, #0x4b, #0x54, #0x92, #0xaa, #0x14, #0x52
	.db #0xa5, #0x94, #0x29, #0x52, #0xa5, #0x14, #0xa8, #0x93
	.db #0x49, #0x92, #0x25, #0xaa, #0x44, #0x29, #0x92, #0x24
	.db #0x4a, #0xa4, #0x49, #0x24, #0x92, #0x92, #0xa5, #0xe6
	.db #0x77, #0x5a, #0xf5, #0xb6, #0x96, #0x10, #0x00, #0x08
	.db #0x14, #0x80, #0x00, #0x04, #0xfb, #0xfe, #0xb7, #0x7b
	.db #0xdb, #0xfd, #0x6f, #0xfe, #0xdb, #0xb6, #0x7d, #0x6f
	.db #0xf6, #0xbf, #0xfd, #0xef, #0xbf, #0xfd, #0xb7, #0xfe
	.db #0x7b, #0xd6, #0xad, #0x5a, #0xb5, #0x6b, #0x6d, #0xd6
	.db #0x5b, #0x6a, #0xb7, #0xda, #0x56, #0xad, #0xdb, #0xb2
	.db #0x56, #0x6d, #0xd5, #0x9a, #0x6d, #0xb2, #0xcd, #0x6d
	.db #0x55, #0xaa, #0xdb, #0x55, #0xaa, #0x6d, #0xaa, #0x55
	.db #0xb6, #0xa5, #0x5a, #0xb6, #0x49, #0xb6, #0x55, #0xaa
	.db #0x55, #0xaa, #0xb5, #0x4b, #0xb4, #0x4b, #0xb4, #0x55
	.db #0xaa, #0x55, #0xaa, #0x55, #0xaa, #0x25, #0xd4, #0x2b
	.db #0xaa, #0x54, #0x4b, #0xa9, #0x2a, #0x55, #0xa4, #0x55
	.db #0xaa, #0x49, #0x95, #0xaa, #0x24, #0xa9, #0x55, #0x92
	.db #0x2a, #0xa4, #0x55, #0x49, #0x92, #0x35, #0x48, #0x92
	.db #0x25, #0x54, #0x49, #0x92, #0x92, #0x25, #0x28, #0xa5
	.db #0x92, #0xe4, #0xe9, #0xf7, #0x6e, #0xb9, #0x77, #0xee
	.db #0xdb, #0x77, #0xfe, #0x52, #0xbe, #0xf6, #0x90, #0x6c
	.db #0x94, #0x00, #0x52, #0x80, #0xff, #0xff, #0xff, #0xdb
	.db #0xbe, #0xf7, #0xff, #0x6e, #0xdd, #0xfb, #0xef, #0xbd
	.db #0xf7, #0xff, #0xde, #0x7b, #0xff, #0xed, #0x7f, #0xff
	.db #0xff, #0x92, #0x6d, #0xbb, #0xd5, #0xdb, #0x5b, #0xb6
	.db #0xd5, #0xdb, #0xb6, #0xaa, #0x77, #0xaa, #0x5d, #0xea
	.db #0x9b, #0xb5, #0xd6, #0xad, #0xb5, #0x6a, #0x56, #0xad
	.db #0xdb, #0x32, #0xd6, #0xad, #0x6a, #0x55, #0xad, #0x6b
	.db #0x54, #0xad, #0xb3, #0xcc, #0x5b, #0x32, #0xad, #0x6a
	.db #0x55, #0xad, #0x52, #0xad, #0xaa, #0x55, #0xaa, #0x55
	.db #0xaa, #0x55, #0xaa, #0x55, #0xaa, #0x55, #0xaa, #0x55
	.db #0xaa, #0x95, #0x6a, #0x49, #0x55, #0xab, #0x54, #0x92
	.db #0xa5, #0x5a, #0xa4, #0x52, #0x4d, #0xa8, #0x93, #0x54
	.db #0x29, #0x4a, #0x92, #0x55, #0xa4, #0x49, #0x95, #0x24
	.db #0xa9, #0x92, #0x25, #0x54, #0xa2, #0x49, #0x95, #0x28
	.db #0x92, #0x24, #0x4e, #0xeb, #0xff, #0xad, #0x7b, #0xff
	.db #0x6a, #0xb7, #0x7b, #0xef, #0xda, #0x75, #0xb6, #0x52
	.db #0x40, #0x00, #0x34, #0xa0, #0xff, #0xff, #0x7f, #0xed
	.db #0xbf, #0xfd, #0xf7, #0xdf, #0x6e, #0xfb, #0xdf, #0xf6
	.db #0x7f, #0xdd, #0xff, #0xf7, #0xbf, #0xfd, #0xef, #0xff
	.db #0xff, #0x24, #0xfb, #0xd7, #0xac, #0x76, #0xdb, #0xad
	.db #0xb6, #0x5a, #0xed, #0x56, #0xdb, #0x6d, #0xd5, #0xae
	.db #0xb5, #0x5a, #0x6d, #0xaa, #0x75, #0xdb, #0x4d, #0xba
	.db #0xd5, #0xab, #0xb6, #0x6c, #0x53, #0xdb, #0xac, #0x53
	.db #0x5b, #0xb6, #0x64, #0xad, #0x5b, #0xa9, #0x56, #0xb5
	.db #0xab, #0x4a, #0xb5, #0x5a, #0xa5, #0xda, #0x95, #0x35
	.db #0x6a, #0xa5, #0x5a, #0xa5, #0x5a, #0x55, #0xaa, #0x55
	.db #0xaa, #0x54, #0xab, #0x52, #0xad, #0x92, #0x6a, #0x95
	.db #0xa4, #0x2a, #0x52, #0x95, #0xaa, #0x24, #0x69, #0x96
	.db #0x91, #0x29, #0xa6, #0x94, #0x52, #0x49, #0x94, #0x29
	.db #0x52, #0x24, #0xa5, #0x4a, #0x94, #0x29, #0x56, #0xbf
	.db #0x1a, #0x56, #0xbf, #0xb9, #0x7f, #0xb6, #0x8f, #0xfd
	.db #0xb3, #0xbb, #0xff, #0xda, #0x76, #0xfb, #0xdd, #0xb7
	.db #0x6a, #0xc4, #0x14, #0xfb, #0xff, #0xef, #0x7b, #0xbd
	.db #0xff, #0xf7, #0xde, #0xff, #0xdb, #0xff, #0xb6, #0xff
	.db #0xdb, #0xff, #0xff, #0xb6, #0xff, #0xff, #0x6d, #0xff
	.db #0xff, #0x49, #0xbe, #0x75, #0xd6, #0xdb, #0xb6, #0x6d
	.db #0x6d, #0xdb, #0xb6, #0x6d, #0xda, #0xd7, #0x5a, #0xed
	.db #0xd5, #0x5b, #0xbb, #0x66, #0xad, #0x5a, #0xb7, #0xea
	.db #0x4d, #0xba, #0xd5, #0xab, #0xb6, #0x5a, #0xb5, #0x6b
	.db #0xd6, #0x95, #0xbb, #0x6a, #0x95, #0x6d, #0xaa, #0x55
	.db #0xb6, #0xa9, #0x6d, #0x4b, #0xb4, #0xaa, #0x55, #0xad
	.db #0xd5, #0x2a, #0xd5, #0xaa, #0x55, #0xad, #0x52, #0xad
	.db #0x52, #0xad, #0x52, #0xad, #0x52, #0x54, #0xab, #0x94
	.db #0x6a, #0x25, #0xc9, #0x9a, #0x24, #0xd5, #0x29, #0x92
	.db #0x54, #0x25, #0xaa, #0x44, #0xaa, #0x49, #0x94, #0x29
	.db #0xa5, #0x92, #0x24, #0x29, #0x52, #0x92, #0x24, #0x4a
	.db #0x91, #0x4a, #0x1f, #0x35, #0x4a, #0x2d, #0x35, #0x1b
	.db #0x16, #0x2d, #0x11, #0x0e, #0x07, #0x1a, #0x05, #0x0d
	.db #0x09, #0x0a, #0x11, #0x3f, #0xbf, #0x57, #0xbb, #0x6f
	.db #0xdd, #0xf7, #0xbe, #0x5b, #0xfe, #0xb7, #0x7d, #0xef
	.db #0xbf, #0xf6, #0xff, #0xdf, #0xfd, #0xef, #0x7f, #0xfb
	.db #0xff, #0x55, #0x6d, #0xbb, #0xb6, #0x76, #0xed, #0xdb
	.db #0xb7, #0xda, #0x6d, #0xdb, #0xb6, #0xb6, #0x6d, #0xd6
	.db #0xda, #0xb7, #0x6d, #0xb5, #0xdb, #0xad, #0xb6, #0x6a
	.db #0xdb, #0xb5, #0x56, #0xba, #0xd5, #0x6b, #0xb6, #0xcd
	.db #0x5a, #0xb5, #0xd6, #0xad, #0x69, #0x5b, #0xd6, #0x35
	.db #0x6d, #0xd2, #0x2d, #0x6b, #0xd4, #0x2d, #0xb3, #0xcc
	.db #0x5a, #0xb3, #0x56, #0xd4, #0x2b, #0x6a, #0x95, #0x6a
	.db #0x55, #0xaa, #0x55, #0xaa, #0x55, #0xaa, #0x55, #0xaa
	.db #0x92, #0x55, #0xaa, #0x54, #0x25, #0xaa, #0x49, #0x52
	.db #0xad, #0x49, #0x92, #0xaa, #0x54, #0x89, #0x52, #0x55
	.db #0x88, #0xb2, #0x45, #0x29, #0x52, #0x24, #0x49, #0x92
	.db #0x24, #0x92, #0x49, #0x22, #0x84, #0x49, #0x10, #0x21
	.db #0x82, #0x08, #0x20, #0x01, #0x08, #0x80, #0x00, #0xc0
	.db #0x50, #0xb0, #0xc0, #0x79, #0xd2, #0xb5, #0x6c, #0xec
	.db #0xdb, #0xbe, #0xf4, #0x6c, #0xdc, #0xba, #0xf5, #0xdf
	.db #0xfe, #0xed, #0xff, #0x76, #0xff, #0xbd, #0xfb, #0xef
	.db #0xff, #0x55, #0xbb, #0x77, #0xd6, #0xbb, #0x76, #0xee
	.db #0xd5, #0x5e, #0xbb, #0xea, #0x5d, #0xdb, #0xb5, #0x6e
	.db #0xb6, #0x6d, #0xdb, #0xb6, #0x6d, #0xda, #0x55, #0xef
	.db #0xac, #0xb5, #0xdb, #0xb6, #0x6a, #0x57, #0xec, #0x5a
	.db #0xb7, #0x6a, #0xd5, #0xae, #0x59, #0x6b, #0x56, #0xad
	.db #0xb3, #0x5a, #0xd5, #0xab, #0x36, #0xd5, #0xaa, #0x36
	.db #0xd5, #0xaa, #0x55, #0xb6, #0x69, #0x4b, #0xb6, #0x59
	.db #0x4b, #0xb4, #0x4b, #0xb4, #0x4b, #0xb4, #0xa5, #0x5a
	.db #0x92, #0xb5, #0x4a, #0x55, #0xa9, #0xca, #0x15, #0x6a
	.db #0x52, #0xa5, #0x4c, #0x32, #0x49, #0x54, #0xaa, #0x45
	.db #0x54, #0xaa, #0x92, #0x49, #0x95, #0x52, #0x49, #0x24
	.db #0x49, #0x94, #0xa2, #0x49, #0x94, #0x48, #0x91, #0x25
	.db #0x48, #0x32, #0xa4, #0x22, #0x48, #0x20, #0x54, #0x7e
	.db #0x60, #0xf2, #0xff, #0xdf, #0x7a, #0xff, #0x6b, #0xfe
	.db #0xdd, #0xf7, #0xfe, #0xdb, #0xff, #0x6d, #0xff, #0xff
	.db #0xb6, #0xff, #0xff, #0xdb, #0xff, #0xff, #0xed, #0x7f
	.db #0xff, #0x55, #0xbb, #0xef, #0xda, #0x5d, #0xf7, #0xaa
	.db #0xde, #0x7b, #0xd5, #0x6e, #0xbb, #0x6d, #0xd6, #0xbb
	.db #0x6d, #0xdb, #0xb6, #0x6d, #0xdb, #0xb6, #0x6d, #0xb6
	.db #0x6d, #0x6d, #0xda, #0xb5, #0x57, #0xba, #0xed, #0x4b
	.db #0x76, #0xad, #0xda, #0xb5, #0x6b, #0x5b, #0xb5, #0xd6
	.db #0x6d, #0xab, #0xd4, #0xad, #0x5b, #0xb2, #0x6d, #0xcd
	.db #0x5a, #0xb5, #0x65, #0xae, #0x59, #0xd3, #0xb6, #0x49
	.db #0xdb, #0xaa, #0x55, #0xaa, #0x55, #0xaa, #0x5a, #0xa5
	.db #0xaa, #0x54, #0xab, #0xaa, #0x54, #0x95, #0x69, #0x96
	.db #0xa9, #0x4a, #0x55, #0xa9, #0x4a, #0x55, #0xb2, #0x8a
	.db #0x55, #0xa8, #0x92, #0x55, #0xa4, #0x2a, #0x55, #0x49
	.db #0x92, #0x24, #0xaa, #0x44, #0x92, #0x2a, #0x24, #0x91
	.db #0x22, #0x44, #0x94, #0x21, #0x04, #0x92, #0x24, #0xff
	.db #0xef, #0x79, #0xff, #0xdf, #0xfb, #0x7f, #0xf7, #0xdd
	.db #0xff, #0xfe, #0xb7, #0xfe, #0xef, #0xff, #0xfb, #0xdf
	.db #0xff, #0xfd, #0xef, #0x7f, #0xfe, #0xef, #0xff, #0x7b
	.db #0xff, #0x6b, #0xdd, #0x76, #0xdb, #0x6f, #0xbc, #0xeb
	.db #0xdd, #0xdb, #0xb6, #0x6f, #0xdd, #0xeb, #0xb6, #0xdd
	.db #0x5b, #0xf6, #0xad, #0x5b, #0xf6, #0xad, #0xbb, #0x6d
	.db #0xdb, #0xdb, #0xb6, #0x6d, #0xdb, #0xb6, #0x6a, #0xd7
	.db #0x5d, #0xb5, #0xb6, #0x6d, #0xd5, #0x5b, #0xb6, #0x6a
	.db #0xd7, #0xac, #0xb5, #0xb6, #0x6b, #0xda, #0x95, #0xb6
	.db #0x6b, #0xd4, #0x5b, #0xb6, #0xa5, #0x5a, #0xb6, #0x65
	.db #0x9a, #0xb6, #0x69, #0x96, #0x55, #0xaa, #0x55, #0xaa
	.db #0x55, #0xaa, #0xaa, #0x55, #0xaa, #0x52, #0xad, #0x52
	.db #0xaa, #0x55, #0xa9, #0x56, #0xa9, #0x95, #0x6a, #0x24
	.db #0x95, #0x6a, #0x24, #0x55, #0xaa, #0x49, #0x55, #0x92
	.db #0x2a, #0x65, #0x88, #0x55, #0x24, #0x49, #0xa9, #0x04
	.db #0x52, #0x48, #0x84, #0x29, #0x20, #0x44, #0x89, #0xc6
	.db #0x46, #0xef, #0xfd, #0x7f, #0xef, #0xfb, #0xbf, #0xfe
	.db #0xf7, #0xdf, #0xfd, #0x77, #0xfe, #0xdf, #0xff, #0xf6
	.db #0x7f, #0xff, #0xff, #0xdb, #0xff, #0xff, #0xbf, #0xfb
	.db #0xff, #0xdb, #0xb6, #0xef, #0x5d, #0xfb, #0xab, #0xde
	.db #0x76, #0xed, #0xdb, #0xb7, #0x7e, #0x6a, #0xed, #0xb7
	.db #0xdd, #0x76, #0xdb, #0xdb, #0xb6, #0x6d, #0xbb, #0xdb
	.db #0xb6, #0x76, #0xad, #0xdb, #0x76, #0xad, #0xdb, #0xb6
	.db #0x6d, #0xd5, #0xbb, #0x6d, #0xd6, #0xdb, #0xb6, #0x6d
	.db #0xaa, #0xdd, #0xb5, #0xd6, #0x5b, #0xea, #0xad, #0x36
	.db #0x75, #0xca, #0xdf, #0xb4, #0xa5, #0x5b, #0xb6, #0xd5
	.db #0xaa, #0x6d, #0x55, #0xaa, #0x5b, #0xb4, #0x4b, #0xb6
	.db #0x69, #0x95, #0xaa, #0x55, #0xaa, #0xb5, #0x4a, #0xb5
	.db #0xaa, #0x55, #0xaa, #0x55, #0xaa, #0x54, #0xab, #0x55
	.db #0xa4, #0x5b, #0xa9, #0x25, #0xda, #0x92, #0x25, #0xda
	.db #0x49, #0x95, #0xb2, #0x22, #0x4d, #0xd2, #0x88, #0x55
	.db #0xaa, #0x44, #0x94, #0x29, #0x04, #0x80, #0x25, #0x0b
	.db #0x02, #0xff, #0x7f, #0xff, #0xb7, #0xfd, #0xdf, #0xff
	.db #0x76, #0xff, #0xbb, #0xff, #0xdf, #0xfb, #0xff, #0x7f
	.db #0xfb, #0xff, #0xdf, #0xff, #0xfd, #0xff, #0x6f, #0xff
	.db #0xff, #0xb6, #0xed, #0xdf, #0xb5, #0x7e, #0xeb, #0xdd
	.db #0xb7, #0x7e, #0xd5, #0xbb, #0xef, #0x5d, #0xf6, #0xdb
	.db #0x6e, #0xbb, #0xed, #0xb6, #0x5b, #0xff, #0xa9, #0xde
	.db #0xbb, #0x75, #0xef, #0x5a, #0xed, #0xdb, #0xb6, #0x6d
	.db #0xdb, #0xb6, #0x6d, #0xdb, #0xb6, #0xda, #0x6d, #0xdb
	.db #0xb6, #0x6d, #0xda, #0xb6, #0x6b, #0xd6, #0x5d, #0xeb
	.db #0xb5, #0xae, #0x5a, #0xb5, #0xd6, #0xdb, #0xaa, #0xb6
	.db #0xd5, #0x5a, #0x6b, #0xd5, #0xb6, #0x29, #0xd7, #0x6c
	.db #0x95, #0xb5, #0x6a, #0x95, #0xda, #0x65, #0xad, #0x5a
	.db #0xd2, #0xad, #0x2a, #0xd5, #0xaa, #0x35, #0x6a, #0x95
	.db #0x6a, #0x95, #0x6a, #0x55, #0xaa, #0x2a, #0xd5, #0xaa
	.db #0x55, #0xa4, #0x2a, #0x55, #0x92, #0xa4, #0x2a, #0x54
	.db #0x22, #0x0d, #0xb4, #0x91, #0x49, #0x24, #0x00, #0x00
	.db #0x00, #0xfb, #0xfb, #0xfd, #0xff, #0xb6, #0xff, #0xff
	.db #0xdb, #0xff, #0xff, #0x6d, #0xff, #0xff, #0xf7, #0x7f
	.db #0xff, #0xff, #0xfd, #0xef, #0x7f, #0xff, #0xf7, #0xff
	.db #0xff, #0xed, #0xde, #0x7b, #0xed, #0xdf, #0xb6, #0xfd
	.db #0x6b, #0xdf, #0xf6, #0x6d, #0xbf, #0xf5, #0x6e, #0xdb
	.db #0x77, #0xee, #0xdd, #0xbb, #0x6b, #0xde, #0x6d, #0xfb
	.db #0xd6, #0x6f, #0xba, #0xf7, #0xae, #0x75, #0x6e, #0xdb
	.db #0x6d, #0xb6, #0xdb, #0xb6, #0x6d, #0xb6, #0xdb, #0x76
	.db #0xed, #0xdb, #0xb6, #0x6d, #0xdb, #0xb6, #0x6d, #0xb6
	.db #0x6d, #0x6d, #0xdb, #0xb6, #0x56, #0xba, #0x6d, #0xd6
	.db #0x5a, #0xeb, #0xad, #0x5a, #0xb5, #0x6b, #0xd6, #0xad
	.db #0x5a, #0xb5, #0x65, #0xae, #0x54, #0xdb, #0xaa, #0xb5
	.db #0x56, #0x6a, #0xad, #0xd5, #0x5a, #0xa5, #0xdb, #0x5a
	.db #0xa5, #0x76, #0xa9, #0x5b, #0x52, #0xad, #0x6a, #0x52
	.db #0xad, #0xaa, #0x55, #0xa9, #0x56, #0x54, #0xa9, #0x53
	.db #0x4a, #0xa9, #0x44, #0x24, #0x89, #0x41, #0x13, #0xe0
	.db #0xf6, #0xff, #0xff, #0xbf, #0xf7, #0xfd, #0xff, #0xdf
	.db #0xfe, #0xf7, #0xff, #0xbf, #0xfb, #0xff, #0xff, #0xef
	.db #0xff, #0xff, #0xfb, #0xff, #0xbf, #0xff, #0xff, #0xfb
	.db #0xff, #0xbe, #0xeb, #0xff, #0x56, #0xfd, #0xef, #0xb6
	.db #0x7b, #0xef, #0xb6, #0x7b, #0xef, #0xb6, #0x7b, #0xef
	.db #0xdd, #0x76, #0xef, #0xdd, #0xbb, #0x77, #0xed, #0xde
	.db #0xbb, #0xdb, #0xed, #0x5e, #0xfb, #0x6b, #0xb7, #0xde
	.db #0x7b, #0xd5, #0x6e, #0xdd, #0xbb, #0xb5, #0x6e, #0x77
	.db #0xee, #0xda, #0x6d, #0xb7, #0xda, #0xbd, #0xb7, #0x6d
	.db #0xdb, #0xdb, #0xb6, #0x6d, #0xdb, #0x6d, #0xdb, #0xb6
	.db #0x6d, #0xda, #0xb5, #0x6b, #0x6e, #0xb5, #0xd6, #0x6d
	.db #0x6d, #0xda, #0xab, #0xb5, #0xdb, #0x6a, #0x56, #0xad
	.db #0xb9, #0x57, #0x6a, #0xb6, #0xd5, #0x6d, #0xda, #0xab
	.db #0xb6, #0x55, #0x6a, #0xdb, #0x55, #0xb6, #0xad, #0x69
	.db #0x56, #0xad, #0x6a, #0xd5, #0xad, #0x52, #0xad, #0x52
	.db #0xd5, #0x24, #0xaa, #0x49, #0x24, #0x42, #0xca, #0xde
	.db #0xf7, #0x9b, #0xff, #0xff, #0xff, #0xfd, #0xdf, #0xff
	.db #0xfe, #0xf7, #0xbf, #0xff, #0xff, #0xfd, #0xef, #0xff
	.db #0xfe, #0xff, #0xff, #0xff, #0xf7, #0xff, #0xff, #0xff
	.db #0xff, #0xff, #0xaa, #0xdf, #0xfb, #0x6e, #0xf7, #0xbd
	.db #0xef, #0xbd, #0xdb, #0xff, #0xb5, #0x6f, #0xfb, #0xee
	.db #0xb7, #0x7b, #0xee, #0xdd, #0x77, #0xbb, #0xee, #0xbd
	.db #0xdb, #0xee, #0xbd, #0xdb, #0xee, #0xb7, #0x7b, #0xee
	.db #0xdb, #0xbd, #0xb7, #0x76, #0xed, #0x5b, #0xbb, #0xf7
	.db #0xae, #0xda, #0x77, #0xed, #0xde, #0xb5, #0x7b, #0xd7
	.db #0xee, #0xba, #0x6d, #0xb7, #0xee, #0xdb, #0xb6, #0x6d
	.db #0xbb, #0xf6, #0x4d, #0xbb, #0xdb, #0xb6, #0x76, #0xab
	.db #0x77, #0xda, #0xad, #0x76, #0xda, #0xd7, #0x6d, #0xad
	.db #0x75, #0xdb, #0xab, #0xb6, #0x76, #0xad, #0xda, #0xb5
	.db #0x6e, #0xdb, #0xd5, #0xae, #0xdb, #0xb5, #0x6a, #0xb7
	.db #0x6d, #0xea, #0x97, #0xbc, #0x69, #0xd7, #0xac, #0x59
	.db #0x66, #0x95, #0x6a, #0x52, #0x25, #0x52, #0xa6, #0x85
	.db #0xff, #0xfe, #0xff, #0xff, #0xff, #0xf7, #0x7f, #0xfd
	.db #0xff, #0xff, #0xef, #0xff, #0xfd, #0xff, #0xff, #0xff
	.db #0xbf, #0xfe, #0xff, #0xff, #0xff, #0xf7, #0xfe, #0xff
	.db #0xff, #0xff, #0xda, #0x77, #0xfd, #0x6f, #0xfb, #0xdd
	.db #0xbf, #0xf6, #0xdb, #0x7d, #0xef, #0xbb, #0xfe, #0x6b
	.db #0xdd, #0xff, #0x6b, #0xde, #0xf7, #0xbb, #0x7d, #0xf7
	.db #0xae, #0x7d, #0xdb, #0xee, #0x7d, #0xdb, #0xef, #0x76
	.db #0xbd, #0xdb, #0xfd, #0xd7, #0x6e, #0xbb, #0x75, #0xee
	.db #0xaf, #0x7a, #0xb7, #0xed, #0xde, #0x6d, #0xfb, #0xae
	.db #0xdd, #0xfb, #0xab, #0xdd, #0x7e, #0xb5, #0xeb, #0x5f
	.db #0xba, #0xf5, #0xaf, #0x5d, #0xfa, #0x67, #0xdd, #0xbb
	.db #0x6b, #0xde, #0xb5, #0xdb, #0x6e, #0xb6, #0xed, #0xdb
	.db #0x5b, #0xb6, #0x6d, #0xed, #0xdb, #0xb6, #0x6d, #0xb6
	.db #0xdb, #0x76, #0xee, #0x55, #0xbe, #0x75, #0xeb, #0xae
	.db #0x5d, #0xf5, #0xb6, #0x6d, #0xdb, #0xb6, #0xda, #0x6d
	.db #0xab, #0xb6, #0xd5, #0xa9, #0x56, #0xa9, #0xdb, #0xff
	.db #0xff, #0xff, #0xff, #0xff, #0xff, #0xff, #0xff, #0x77
	.db #0xff, #0xff, #0xff, #0xfe, #0xbf, #0xff, #0xff, #0xff
	.db #0xf7, #0xff, #0xff, #0xff, #0xff, #0x7e, #0xff, #0xff
	.db #0xff, #0xff, #0xb6, #0xdf, #0xfb, #0xef, #0xbe, #0xfb
	.db #0xb7, #0xfe, #0xdb, #0x7f, #0xed, #0xdf, #0x76, #0xff
	.db #0xdb, #0x76, #0xff, #0xdb, #0xbe, #0xf7, #0xdb, #0x7f
	.db #0xed, #0xbb, #0xdf, #0xf6, #0xbb, #0xdf, #0xf6, #0xbb
	.db #0xdf, #0xfd, #0xd6, #0x6f, #0xfd, #0xab, #0xf7, #0x5e
	.db #0xed, #0xbb, #0x77, #0xee, #0x5d, #0xfb, #0xb6, #0xef
	.db #0xb6, #0xfd, #0xdb, #0xb6, #0x7f, #0xd5, #0xbb, #0xef
	.db #0x76, #0xed, #0xdb, #0xbf, #0xea, #0xb7, #0xde, #0x75
	.db #0xef, #0xdd, #0xbb, #0x76, #0xeb, #0xdd, #0xbe, #0x75
	.db #0xeb, #0xdf, #0xb5, #0x6e, #0xfd, #0xd5, #0xaf, #0xfd
	.db #0x6a, #0xb7, #0xfd, #0xab, #0xdf, #0x7d, #0xea, #0xb7
	.db #0xdf, #0xfa, #0xd5, #0xbf, #0xda, #0x77, #0xee, #0x6d
	.db #0xdb, #0xb6, #0xba, #0xd5, #0x6a, #0xc5, #0xdd, #0xff
	.db #0xff, #0xff, #0xff, #0xff, #0xff, #0xff, #0xff, #0xdf
	.db #0xff, #0xff, #0xff, #0xf7, #0xff, #0xff, #0xff, #0xff
	.db #0xff, #0xff, #0xfb, #0x7f, #0xff, #0xff, #0xff, #0xff
	.db #0xff, #0xff, #0x6d, #0xff, #0xb6, #0xff, #0xed, #0xdf
	.db #0x7d, #0xfb, #0x6e, #0xff, #0xdb, #0xbf, #0xfb, #0xf6
	.db #0xdf, #0xbf, #0xfa, #0xb7, #0x7f, #0xf6, #0xdd, #0xbf
	.db #0xfb, #0xb7, #0x7e, #0xed, #0xdf, #0x7d, #0xf6, #0xef
	.db #0xdd, #0x7e, #0xdb, #0xf7, #0x6e, #0xbd, #0xdb, #0xf7
	.db #0xbe, #0xed, #0xb7, #0x7b, #0xef, #0xb6, #0x7d, #0xf7
	.db #0xae, #0xfd, #0xdb, #0xee, #0xbf, #0x75, #0xef, #0xde
	.db #0xfb, #0xad, #0x7e, #0xdb, #0xed, #0x7f, #0xda, #0xb7
	.db #0xfd, #0x6e, #0xdb, #0xff, #0xaa, #0x77, #0xfe, #0xab
	.db #0x7d, #0xf6, #0xaf, #0xfb, #0xb6, #0xdf, #0xfa, #0x6d
	.db #0xdf, #0xfd, #0x6b, #0xde, #0xf7, #0xbb, #0xde, #0xf7
	.db #0xee, #0xbd, #0xf6, #0xdf, #0xed, #0x7b, #0xde, #0xf7
	.db #0xdd, #0xbb, #0xed, #0xde, #0x5b, #0xc4, #0x97, #0xff
	.db #0xff, #0xff, #0xff, #0xff, #0xff, #0xff, #0xff, #0xff
	.db #0xff, #0xf7, #0xff, #0xff, #0xff, #0xff, #0xfd, #0xff
	.db #0xff, #0x7f, #0xff, #0xff, #0xff, #0xff, #0xff, #0xff
	.db #0xff, #0xff, #0xf7, #0xbb, #0xff, #0xee, #0x7f, #0xed
	.db #0xff, #0xdb, #0xff, #0x6d, #0xff, #0xdb, #0xfe, #0xb7
	.db #0xfe, #0xb7, #0xfb, #0xff, #0xd7, #0x7d, #0xff, #0x6d
	.db #0xf7, #0xbf, #0x7d, #0xf7, #0xdb, #0xff, #0x6e, #0xfb
	.db #0xde, #0xff, #0x6b, #0xde, #0xf7, #0xfb, #0x5f, #0xf6
	.db #0xbb, #0xfd, #0xef, #0x5b, #0xfd, #0xb7, #0xdf, #0xfa
	.db #0xb7, #0xfd, #0x6e, #0xbf, #0xf5, #0x6f, #0xfd, #0x6e
	.db #0xf7, #0xbd, #0xef, #0xfb, #0xde, #0xb7, #0x7b, #0xfd
	.db #0x6f, #0xbb, #0xfe, #0x6b, #0xdd, #0xff, #0xdb, #0x7d
	.db #0xf7, #0xaf, #0xfe, #0xb5, #0xdf, #0xee, #0xfd, #0xb7
	.db #0xff, #0xda, #0xff, #0xb7, #0xee, #0x7b, #0xff, #0xb6
	.db #0xff, #0x6d, #0xfe, #0xb7, #0x7e, #0xf7, #0xdb, #0xfe
	.db #0xf7, #0xdd, #0xbe, #0xf3, #0xcf, #0x38, #0x73, #0xff
	.db #0xff, #0xff, #0xff, #0xff, #0xff, #0xff, #0xff, #0xff
	.db #0xff, #0xff, #0xff, #0xdf, #0xfb, #0xff, #0xff, #0xff
	.db #0xff, #0xff, #0xff, #0xff, #0xff, #0xff, #0xff, #0xff
	.db #0xff, #0xff, #0xfe, #0xb7, #0xff, #0xf6, #0xdf, #0xff
	.db #0xf6, #0xdf, #0xfd, #0xef, #0xff, #0xb6, #0xff, #0xed
	.db #0xff, #0xdb, #0xfe, #0xef, #0xfd, #0xdf, #0xfb, #0xbf
	.db #0xdb, #0xff, #0xfb, #0xef, #0xde, #0xfd, #0xef, #0xdf
	.db #0xf6, #0xff, #0xdb, #0xff, #0xb6, #0xff, #0xdb, #0xf7
	.db #0xfd, #0xde, #0xef, #0xfb, #0xdd, #0xff, #0xf6, #0x6f
	.db #0xfd, #0xf7, #0xdf, #0xfd, #0xdb, #0xff, #0xed, #0xbf
	.db #0xfb, #0xf7, #0xde, #0xfd, #0xb7, #0xff, #0xed, #0xbf
	.db #0xfb, #0xf7, #0xdd, #0xbf, #0xfb, #0xee, #0xbf, #0xfb
	.db #0xf7, #0xdd, #0xff, #0xed, #0xbf, #0xf6, #0xff, #0xed
	.db #0xbf, #0xf6, #0xff, #0xed, #0x7f, #0xfb, #0xef, #0xfd
	.db #0xdf, #0xf7, #0xfb, #0xff, #0xef, #0xbd, #0xf6, #0xee
	.db #0xfa, #0xf5, #0xdb, #0xfe, #0xbd, #0x4a, #0xfe, #0xff
	.db #0xff, #0xff, #0xff, #0xff, #0xff, #0xff, #0xff, #0xff
	.db #0xff, #0xff, #0xff, #0xff, #0xff, #0xff, #0xff, #0xff
	.db #0xff, #0xff, #0xff, #0xff, #0xff, #0xff, #0xff, #0xff
